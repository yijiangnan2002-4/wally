/* Copyright Statement:
 *
 * (C) 2017  Airoha Technology Corp. All rights reserved.
 *
 * This software/firmware and related documentation ("Airoha Software") are
 * protected under relevant copyright laws. The information contained herein
 * is confidential and proprietary to Airoha Technology Corp. ("Airoha") and/or its licensors.
 * Without the prior written permission of Airoha and/or its licensors,
 * any reproduction, modification, use or disclosure of Airoha Software,
 * and information contained herein, in whole or in part, shall be strictly prohibited.
 * You may only use, reproduce, modify, or distribute (as applicable) Airoha Software
 * if you have agreed to and been bound by the applicable license agreement with
 * Airoha ("License Agreement") and been granted explicit permission to do so within
 * the License Agreement ("Permitted User").  If you are not a Permitted User,
 * please cease any access or use of Airoha Software immediately.
 * BY OPENING THIS FILE, RECEIVER HEREBY UNEQUIVOCALLY ACKNOWLEDGES AND AGREES
 * THAT AIROHA SOFTWARE RECEIVED FROM AIROHA AND/OR ITS REPRESENTATIVES
 * ARE PROVIDED TO RECEIVER ON AN "AS-IS" BASIS ONLY. AIROHA EXPRESSLY DISCLAIMS ANY AND ALL
 * WARRANTIES, EXPRESS OR IMPLIED, INCLUDING BUT NOT LIMITED TO THE IMPLIED WARRANTIES OF
 * MERCHANTABILITY, FITNESS FOR A PARTICULAR PURPOSE OR NONINFRINGEMENT.
 * NEITHER DOES AIROHA PROVIDE ANY WARRANTY WHATSOEVER WITH RESPECT TO THE
 * SOFTWARE OF ANY THIRD PARTY WHICH MAY BE USED BY, INCORPORATED IN, OR
 * SUPPLIED WITH AIROHA SOFTWARE, AND RECEIVER AGREES TO LOOK ONLY TO SUCH
 * THIRD PARTY FOR ANY WARRANTY CLAIM RELATING THERETO. RECEIVER EXPRESSLY ACKNOWLEDGES
 * THAT IT IS RECEIVER'S SOLE RESPONSIBILITY TO OBTAIN FROM ANY THIRD PARTY ALL PROPER LICENSES
 * CONTAINED IN AIROHA SOFTWARE. AIROHA SHALL ALSO NOT BE RESPONSIBLE FOR ANY AIROHA
 * SOFTWARE RELEASES MADE TO RECEIVER'S SPECIFICATION OR TO CONFORM TO A PARTICULAR
 * STANDARD OR OPEN FORUM. RECEIVER'S SOLE AND EXCLUSIVE REMEDY AND AIROHA'S ENTIRE AND
 * CUMULATIVE LIABILITY WITH RESPECT TO AIROHA SOFTWARE RELEASED HEREUNDER WILL BE,
 * AT AIROHA'S OPTION, TO REVISE OR REPLACE AIROHA SOFTWARE AT ISSUE,
 * OR REFUND ANY SOFTWARE LICENSE FEES OR SERVICE CHARGE PAID BY RECEIVER TO
 * AIROHA FOR SUCH AIROHA SOFTWARE AT ISSUE.
 */

#include "hal_spm.h"

#ifdef HAL_SLEEP_MANAGER_ENABLED

#include <stdio.h>
#include <string.h>
#include "hal_log.h"
#include "memory_attribute.h"
#include "hal_nvic.h"
#include "hal_nvic_internal.h"
#include "assert.h"
#include "hal_gpt.h"
#include "hal_platform.h"
#include "hal_wdt_internal.h"
#include "hal_sleep_manager.h"
#include "hal_sleep_manager_internal.h"
#include "hal_pmu_ddie.h"

/* SPM Code Rev : pcm_suspend_20230327.spm */
#ifndef AIR_CPU_IN_SECURITY_MODE
const unsigned int pcm_event_vector_parameter[8] = {0xc0031,0x15c0033,0x1f0035,0x1310030,0x4c0034,0x0,0x0,0x0};

#define PCM_IM_MAX_LENGTH 1648

static const unsigned int spm_im[PCM_IM_MAX_LENGTH] = {
0x18c0001f,0x42140204,0xe0e0001d,0xe0e0001f,0xe0e0001e,0xe0e0001a,0xe0e00012,0x18c0001f,0x42140810,
0xe0e00060,0xf0000000,0x17c07c1f,0x18c0001f,0x42140810,0xe0e0004f,0x18c0001f,0x421403a0,0xe0e00000,
0x1940001f,0x421401f0,0xe1600003,0x1940001f,0x42140184,0xe1600000,0xe8208000,0x42140318,0x0b16ff08,
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0x18c0001f,0x50040000,0xe0e00000,0x1b80001f,0x20000a50,0x18c0001f,0x421401d0,0xe0e00101,0xd00001a0,
0x17c07c1f};

#else
/* All In Secure Environment */
const unsigned int pcm_event_vector_parameter[8] = {0xc0031,0x15c0033,0x1f0035,0x1310030,0x4c0034,0x0,0x0,0x0};

#define PCM_IM_MAX_LENGTH 1648

static const unsigned int spm_im[PCM_IM_MAX_LENGTH] = {
0x18c0001f,0x42140204,0xe0e0001d,0xe0e0001f,0xe0e0001e,0xe0e0001a,0xe0e00012,0x18c0001f,0x42140810,
0xe0e00060,0xf0000000,0x17c07c1f,0x18c0001f,0x42140810,0xe0e0004f,0x18c0001f,0x421403a0,0xe0e00000,
0x1940001f,0x421401f0,0xe1600003,0x1940001f,0x42140184,0xe1600000,0xe8208000,0x42140318,0x0b16ff08,
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0x18c0001f,0x40040000,0xe0e00000,0x1b80001f,0x20000a50,0x18c0001f,0x421401d0,0xe0e00101,0xd00001a0,
0x17c07c1f};
#endif

static struct {
    uint32_t conn_top_on;
    uint32_t conn_top_off;
    uint32_t audio_sys;
    uint32_t audio_anc;
    uint32_t audio_hs;
    uint32_t dsp;
    uint32_t perisys;
    uint32_t vow;
    uint32_t colias_top;
} mtcmos_resource;

uint32_t manual_spm_read_im(uint32_t addr);
void manual_spm_write_im(uint32_t addr, uint32_t data);
ATTR_ZIDATA_IN_TCM volatile uint32_t dsp_wakeup_source_mask = 0;
ATTR_ZIDATA_IN_TCM volatile uint8_t dsp_pwr_off_flag = 0;
static int hw_latency_time_32k;

static void spm_mtcmos_audio_anc_on(void);
static void spm_mtcmos_audio_anc_off(void);
static void spm_mtcmos_audio_sys_on(void);
static void spm_mtcmos_audio_sys_off(void);
static void spm_mtcmos_audio_hs_on(void);
static void spm_mtcmos_audio_hs_off(void);
static void spm_mtcmos_conn_top_on_on(void);
static void spm_mtcmos_conn_top_on_off(void);
static void spm_mtcmos_conn_top_off_on(void);
static void spm_mtcmos_conn_top_off_off(void);
static void spm_mtcmos_dsp_on(void);
static void spm_mtcmos_dsp_off(void);
static void spm_mtcmos_perisys_on(void);
static void spm_mtcmos_perisys_off(void);
static void spm_mtcmos_vow_on(void);
static void spm_mtcmos_vow_off(void);
static void spm_mtcmos_colias_top_on(void);
static void spm_mtcmos_colias_top_off(void);


void manual_spm_write_im(uint32_t addr, uint32_t data)
{
    *SPM_PCM_IM_HOST_RW_PTR = 0x01010000 | addr;
    *SPM_PCM_IM_HOST_RW_DAT = data;
    return;
}

uint32_t manual_spm_read_im(uint32_t addr)
{
    uint32_t data;
    *SPM_PCM_IM_HOST_RW_PTR = 0x01000000 | addr;
    data = *SPM_PCM_IM_HOST_RW_DAT;
    *SPM_PCM_IM_HOST_RW_PTR = 0;
    return (data);
}

int spm_init(void)
{
    int result = 0;
    uint32_t i, status;

    //spm_debug_io(0x45444342);
    /* [4]: Resets PCM */
    *SPM_PCM_CON0 = 0x0B160000 | 0x10;
    hal_gpt_delay_us(10);
    *SPM_PCM_CON0 = 0x0B160000;
    hal_gpt_delay_us(10);

    /* Load PCM_EVENT_VECTOR[0-7] */
    *SPM_PCM_EVENT_VECTOR0 = pcm_event_vector_parameter[0];
    *SPM_PCM_EVENT_VECTOR1 = pcm_event_vector_parameter[1];
    *SPM_PCM_EVENT_VECTOR2 = pcm_event_vector_parameter[2];
    *SPM_PCM_EVENT_VECTOR3 = pcm_event_vector_parameter[3];
    *SPM_PCM_EVENT_VECTOR4 = pcm_event_vector_parameter[4];
    *SPM_PCM_EVENT_VECTOR5 = pcm_event_vector_parameter[5];
    *SPM_PCM_EVENT_VECTOR6 = pcm_event_vector_parameter[6];
    *SPM_PCM_EVENT_VECTOR7 = pcm_event_vector_parameter[7];

    /* PCM kick*/
    *SPM_POWER_ON_VAL0 = 0;             /* POWER_ON_VAL0 */
    *SPM_POWER_ON_VAL1 = 0x84;          /* POWER_ON_VAL1 */
    *SPM_PCM_REG_DATA_INI = *SPM_POWER_ON_VAL0 | 0x1; /* [0]: sc_xo_cg_en default =1 */
    *SPM_PCM_PWR_IO_EN = 0x00010000;    /* for R0 */
    *SPM_PCM_PWR_IO_EN = 0x00000000;
    *SPM_PCM_REG_DATA_INI = *SPM_POWER_ON_VAL1;
    *SPM_PCM_PWR_IO_EN = 0x00800000;    /* for R7 */
    *SPM_PCM_PWR_IO_EN = 0x00000000;
    *SPM_CLK_SETTLE = 0x3;           /* CLK_SETTLE */
    *SPM_PCM_PWR_IO_EN = 0x1;

    *SPM_SLEEP_WAKEUP_EVENT_MASK = 0x0;           /* mask all AP wakeup event */

    /* Init IM Length and pointer */
    *SPM_PCM_IM_LEN = PCM_IM_MAX_LENGTH;
    *SPM_PCM_IM_PTR = (uint32_t)spm_im;
    /* manual load spm code */
    for (i = 0; i < PCM_IM_MAX_LENGTH; i++) {
        manual_spm_write_im(i, spm_im[i]);
    }
    *SPM_PCM_CON1 = 0x0B163C49;
    /* Kick IM process */
    *SPM_PCM_CON0 = 0x0B160002;

    /* Wait ready state */
    do {
        status = (*SPM_PCM_FSM_STA >> 9) & 0x1;
    } while (status != 0x01);

    *SPM_SEQUENCER_26M_REG_1 = 0x3F;
    *SPM_SEQUENCER_26M_REG_2 = 0x1F;

#if defined (AIR_BTA_IC_PREMIUM_G3_TYPE_P)
//    *((volatile uint32_t *)(SPM_BASE + 0x0104)) = 0x0;         /* rg_active_guard_time */
    *SPM_SEQUENCER_32K_REG_1 = 0x0;
//    *((volatile uint32_t *)(SPM_BASE + 0x0108)) = 0x11;         /* rg_sleep_guard_time */
    *SPM_SEQUENCER_32K_REG_2 = 0x11;
//    *((volatile uint32_t *)(SPM_BASE + 0x010C)) = 0x0;        /* pmu_en_delay = 0,osc_en_delay = 0,xo_en_delay = 7 */
    *SPM_SEQUENCER_32K_REG_3 = 0x0;
//    *((volatile uint32_t *)(SPM_BASE + 0x0110)) = 0x85;        /* rg_vcore_xo_settle_time */
    *SPM_SEQUENCER_32K_REG_4 = 0x85;

#elif (defined (AIR_BTA_IC_PREMIUM_G3_TYPE_S) || defined (AIR_BTA_IC_PREMIUM_G3_TYPE_A) || defined (AIR_BTA_IC_PREMIUM_G3_TYPE_D))
//    *((volatile uint32_t *)(SPM_BASE + 0x0104)) = 0x0;         /* rg_active_guard_time */
    *SPM_SEQUENCER_32K_REG_1 = 0x0;
//    *((volatile uint32_t *)(SPM_BASE + 0x0108)) = 0x0;         /* rg_sleep_guard_time */
    *SPM_SEQUENCER_32K_REG_2 = 0x0;
//    *((volatile uint32_t *)(SPM_BASE + 0x010C)) = 0x0;        /* pmu_en_delay = 0,osc_en_delay = 0,xo_en_delay = 7 */
    *SPM_SEQUENCER_32K_REG_3 = 0x0;
//    *((volatile uint32_t *)(SPM_BASE + 0x0110)) = 0x85;        /* rg_vcore_xo_settle_time */
    *SPM_SEQUENCER_32K_REG_4 = 0x85;
#endif

    hw_latency_time_32k = spm_latency_time_checking(); //SPM Latency Time
    //hw_latency_time_ms = (uint32_t)((((float)hw_latency_time_32k) * (1/32.768))) + 1;

    /* Wakeup Source mask setting */
    *SPM_CMSYS_WAKEUP_SOURCE_MASK = 0x20;
    *SPM_DSP_WAKEUP_SOURCE_MASK = 0x0;

    *SPM_SKIP_SFC_EMI_TASK |= (1 << 8);    /* SKIP SFC */

    for (i = 0; i < PCM_IM_MAX_LENGTH; i++) {
        /* Check SPM Code */
        if (manual_spm_read_im(i) != spm_im[i]) {
            log_hal_msgid_info("SPM Code loading Fail\r\n", 0);
            return (result++);
        }
    }

    /* [4]: Resets PCM */
    *SPM_PCM_CON0 = 0x0B160000 | 0x10;
    hal_gpt_delay_us(10);
    *SPM_PCM_CON0 = 0x0B160000;
    hal_gpt_delay_us(10);

    /* Disable DCXO in sleep mode */
    *SPM_CONN_AUDIO_ABB_XO_SIDEBAND = 0;

    /* SPM Kick Start */
    *SPM_PCM_CON0 = 0x0B160103;

    /* Clear INFRA Power off flag */
    SPM_INFRA_OFF_FLAG = 0;
    return (result);
}

void spm_audio_mtcmos_control_internal(spm_mtcmos_type_t mtcmos, spm_mtcmos_ctrl_t ctrl)
{
    static uint8_t audio_sys_resource_control = 1;

    if ((mtcmos == SPM_MTCMOS_AUDIO_SYS || mtcmos == SPM_MTCMOS_AUDIO_ANC || mtcmos == SPM_MTCMOS_AUDIO_HS)) {
        if (ctrl == SPM_MTCMOS_PWR_ENABLE) {
            if (mtcmos == SPM_MTCMOS_AUDIO_SYS) {
                spm_mtcmos_audio_sys_on();
                audio_sys_resource_control = 1;
            } else if (mtcmos == SPM_MTCMOS_AUDIO_ANC) {
                spm_mtcmos_audio_sys_on();
                spm_mtcmos_audio_anc_on();
            } else if (mtcmos == SPM_MTCMOS_AUDIO_HS) {
                spm_mtcmos_audio_sys_on();
                spm_mtcmos_audio_hs_on();
            }
        } else {
            if (mtcmos == SPM_MTCMOS_AUDIO_SYS) {
                if ((*SPM_PWR_STATUS & 0x60) == 0) {   // CHECK AUDIO_HS & AUDIO_ANC BOTH OFF
                    spm_mtcmos_audio_sys_off();
                }
                audio_sys_resource_control = 0;
            } else if (mtcmos == SPM_MTCMOS_AUDIO_ANC) {
                spm_mtcmos_audio_anc_off();
                if ((audio_sys_resource_control == 0) && ((*SPM_PWR_STATUS & 0x40) == 0)) {  // CHECK NO ONE IS USING AUDIO_HS & AUDIO_SYS
                    spm_mtcmos_audio_sys_off();
                }
            } else if (mtcmos == SPM_MTCMOS_AUDIO_HS) {
                spm_mtcmos_audio_hs_off();
                if ((audio_sys_resource_control == 0) && ((*SPM_PWR_STATUS & 0x20) == 0)) {  // CHECK NO ONE IS USING AUDIO_ANC & AUDIO_SYS
                    spm_mtcmos_audio_sys_off();
                }
            }
        }
    } else {
        //log_hal_msgid_info("spm_audio_mtcmos_control is not audio\r\n", 0);
        assert(0);
    }
}

void spm_conn_top_mtcmos_control_internal(spm_mtcmos_type_t mtcmos, spm_mtcmos_ctrl_t ctrl)
{
    if ((mtcmos == SPM_MTCMOS_CONN_TOP_OFF || mtcmos == SPM_MTCMOS_CONN_TOP_ON)) {
        if (ctrl == SPM_MTCMOS_PWR_ENABLE) {
            spm_mtcmos_conn_top_on_on();
            spm_mtcmos_conn_top_off_on();
        } else {
            spm_mtcmos_conn_top_off_off();
            spm_mtcmos_conn_top_on_off();
        }
    } else {
        log_hal_msgid_info("spm_conn_top_mtcmos_control is not conn_top\r\n", 0);
    }
}

void spm_control_mtcmos_internal(spm_mtcmos_type_t mtcmos, spm_mtcmos_ctrl_t ctrl)
{
    bool clock_old_status1, clock_old_status2, clock_old_status3;

    if ((mtcmos == SPM_MTCMOS_CONN_TOP_ON || mtcmos == SPM_MTCMOS_CONN_TOP_OFF)) {
        spm_conn_top_mtcmos_control_internal(mtcmos, ctrl);
        return;
    }

    if (mtcmos == SPM_MTCMOS_AUDIO_SYS || mtcmos == SPM_MTCMOS_AUDIO_ANC || mtcmos == SPM_MTCMOS_AUDIO_HS) {

        clock_old_status1 = hal_clock_is_enabled(HAL_CLOCK_CG_AUD_INTBUS);
        clock_old_status2 = hal_clock_is_enabled(HAL_CLOCK_CG_AUD_ENGINE_BUS);
        clock_old_status3 = hal_clock_is_enabled(HAL_CLOCK_CG_DSP);

        if (clock_old_status1 == false || clock_old_status2 == false || clock_old_status3 == false) {
            hal_clock_enable(HAL_CLOCK_CG_AUD_INTBUS);
            hal_clock_enable(HAL_CLOCK_CG_AUD_ENGINE_BUS);
            hal_clock_enable(HAL_CLOCK_CG_DSP);
        }

        spm_audio_mtcmos_control_internal(mtcmos, ctrl);

        if (clock_old_status1 == false) {
            hal_clock_disable(HAL_CLOCK_CG_AUD_INTBUS);
        }
        if (clock_old_status2 == false) {
            hal_clock_disable(HAL_CLOCK_CG_AUD_ENGINE_BUS);
        }
        if (clock_old_status3 == false) {
            hal_clock_disable(HAL_CLOCK_CG_DSP);
        }

        return;
    }

    if (mtcmos == SPM_MTCMOS_DSP) {

        clock_old_status1 = hal_clock_is_enabled(HAL_CLOCK_CG_DSP);
        if (clock_old_status1 == false) {
            hal_clock_enable(HAL_CLOCK_CG_DSP);
        }

        if (ctrl == SPM_MTCMOS_PWR_DISABLE) {
            /* DSP MTCMOS OFF */
            spm_mtcmos_dsp_off();
        } else {
            /* DSP MTCMOS ON */
            spm_mtcmos_dsp_on();
        }

        if (clock_old_status1 == false) {
            hal_clock_disable(HAL_CLOCK_CG_DSP);
        }

        return;
    }

    if (mtcmos == SPM_MTCMOS_PERISYS) {
        if (ctrl == SPM_MTCMOS_PWR_DISABLE) {
            /* PERISYS MTCMOS OFF */
            spm_mtcmos_perisys_off();
        } else {
            /* PERISYS MTCMOS ON */
            spm_mtcmos_perisys_on();
        }
        return;
    }

    if (mtcmos == SPM_MTCMOS_VOW) {

        clock_old_status1 = hal_clock_is_enabled(HAL_CLOCK_CG_AUD_VOW_BUS);
        if (clock_old_status1 == false) {
            hal_clock_enable(HAL_CLOCK_CG_AUD_VOW_BUS);
        }

        if (ctrl == SPM_MTCMOS_PWR_DISABLE) {
            /* SPM_MTCMOS_VOW MTCMOS OFF */
            spm_mtcmos_vow_off();
        } else {
            /* SPM_MTCMOS_VOW MTCMOS ON */
            spm_mtcmos_vow_on();
        }

        if (clock_old_status1 == false) {
            hal_clock_disable(HAL_CLOCK_CG_AUD_VOW_BUS);
        }

        return;
    }

    if (mtcmos == SPM_MTCMOS_COLIAS_TOP) {
        if (ctrl == SPM_MTCMOS_PWR_DISABLE) {
            /* SPM_MTCMOS_COLIAS_TOP MTCMOS OFF */
            spm_mtcmos_colias_top_off();
        } else {
            /* SPM_MTCMOS_COLIAS_TOP MTCMOS ON */
            spm_mtcmos_colias_top_on();
        }
        return;
    }
}

uint32_t spm_control_mtcmos(spm_mtcmos_type_t mtcmos, spm_mtcmos_ctrl_t ctrl)
{
    uint32_t mask;

    log_hal_msgid_info("[SLP] spm_control_mtcmos=%d, control=%d\r\n", 2, mtcmos, ctrl);

    hal_nvic_save_and_set_interrupt_mask_special(&mask);
    if (mtcmos == SPM_MTCMOS_CONN_TOP_ON) {
        if (ctrl == SPM_MTCMOS_PWR_DISABLE) {
            if (mtcmos_resource.conn_top_on == 0) {
                spm_control_mtcmos_internal(SPM_MTCMOS_CONN_TOP_ON, SPM_MTCMOS_PWR_DISABLE);
                hal_nvic_restore_interrupt_mask_special(mask);
                return 0;
            }
            mtcmos_resource.conn_top_on--;
            if (mtcmos_resource.conn_top_on == 0) {
                spm_control_mtcmos_internal(SPM_MTCMOS_CONN_TOP_ON, SPM_MTCMOS_PWR_DISABLE);
            }
        } else {
            mtcmos_resource.conn_top_on++;
            if (mtcmos_resource.conn_top_on == 1) {
                spm_control_mtcmos_internal(SPM_MTCMOS_CONN_TOP_ON, SPM_MTCMOS_PWR_ENABLE);
            }
        }
        hal_nvic_restore_interrupt_mask_special(mask);
        return (mtcmos_resource.conn_top_on);
    }

    if (mtcmos == SPM_MTCMOS_CONN_TOP_OFF) {
        if (ctrl == SPM_MTCMOS_PWR_DISABLE) {
            if (mtcmos_resource.conn_top_off == 0) {
                spm_control_mtcmos_internal(SPM_MTCMOS_CONN_TOP_OFF, SPM_MTCMOS_PWR_DISABLE);
                hal_nvic_restore_interrupt_mask_special(mask);
                return 0;
            }
            mtcmos_resource.conn_top_off--;
            if (mtcmos_resource.conn_top_off == 0) {
                spm_control_mtcmos_internal(SPM_MTCMOS_CONN_TOP_OFF, SPM_MTCMOS_PWR_DISABLE);
            }
        } else {
            mtcmos_resource.conn_top_off++;
            if (mtcmos_resource.conn_top_off == 1) {
                spm_control_mtcmos_internal(SPM_MTCMOS_CONN_TOP_OFF, SPM_MTCMOS_PWR_ENABLE);
            }
        }
        hal_nvic_restore_interrupt_mask_special(mask);
        return (mtcmos_resource.conn_top_off);
    }

    if (mtcmos == SPM_MTCMOS_AUDIO_SYS) {
        if (ctrl == SPM_MTCMOS_PWR_DISABLE) {
            if (mtcmos_resource.audio_sys == 0) {
                spm_control_mtcmos_internal(SPM_MTCMOS_AUDIO_SYS, SPM_MTCMOS_PWR_DISABLE);
                hal_nvic_restore_interrupt_mask_special(mask);
                return 0;
            }
            mtcmos_resource.audio_sys--;
            if (mtcmos_resource.audio_sys == 0) {
                spm_control_mtcmos_internal(SPM_MTCMOS_AUDIO_SYS, SPM_MTCMOS_PWR_DISABLE);
            }
        } else {
            mtcmos_resource.audio_sys++;
            if (mtcmos_resource.audio_sys == 1) {
                spm_control_mtcmos_internal(SPM_MTCMOS_AUDIO_SYS, SPM_MTCMOS_PWR_ENABLE);
            }
        }
        hal_nvic_restore_interrupt_mask_special(mask);
        return (mtcmos_resource.audio_sys);
    }

    if (mtcmos == SPM_MTCMOS_AUDIO_ANC) {
        if (ctrl == SPM_MTCMOS_PWR_DISABLE) {
            if (mtcmos_resource.audio_anc == 0) {
                spm_control_mtcmos_internal(SPM_MTCMOS_AUDIO_ANC, SPM_MTCMOS_PWR_DISABLE);
                hal_nvic_restore_interrupt_mask_special(mask);
                return 0;
            }
            mtcmos_resource.audio_anc--;
            if (mtcmos_resource.audio_anc == 0) {
                spm_control_mtcmos_internal(SPM_MTCMOS_AUDIO_ANC, SPM_MTCMOS_PWR_DISABLE);
            }
        } else {
            mtcmos_resource.audio_anc++;
            if (mtcmos_resource.audio_anc == 1) {
                spm_control_mtcmos_internal(SPM_MTCMOS_AUDIO_ANC, SPM_MTCMOS_PWR_ENABLE);
            }
        }
        hal_nvic_restore_interrupt_mask_special(mask);
        return (mtcmos_resource.audio_anc);
    }

    if (mtcmos == SPM_MTCMOS_AUDIO_HS) {
        if (ctrl == SPM_MTCMOS_PWR_DISABLE) {
            if (mtcmos_resource.audio_hs == 0) {
                spm_control_mtcmos_internal(SPM_MTCMOS_AUDIO_HS, SPM_MTCMOS_PWR_DISABLE);
                hal_nvic_restore_interrupt_mask_special(mask);
                return 0;
            }
            mtcmos_resource.audio_hs--;
            if (mtcmos_resource.audio_hs == 0) {
                spm_control_mtcmos_internal(SPM_MTCMOS_AUDIO_HS, SPM_MTCMOS_PWR_DISABLE);
            }
        } else {
            mtcmos_resource.audio_hs++;
            if (mtcmos_resource.audio_hs == 1) {
                spm_control_mtcmos_internal(SPM_MTCMOS_AUDIO_HS, SPM_MTCMOS_PWR_ENABLE);
            }
        }
        hal_nvic_restore_interrupt_mask_special(mask);
        return (mtcmos_resource.audio_hs);
    }

    if (mtcmos == SPM_MTCMOS_DSP) {
        if (ctrl == SPM_MTCMOS_PWR_DISABLE) {
            if (mtcmos_resource.dsp == 0) {
                spm_control_mtcmos_internal(SPM_MTCMOS_DSP, SPM_MTCMOS_PWR_DISABLE);
                hal_nvic_restore_interrupt_mask_special(mask);
                return 0;
            }
            mtcmos_resource.dsp--;
            if (mtcmos_resource.dsp == 0) {
                spm_control_mtcmos_internal(SPM_MTCMOS_DSP, SPM_MTCMOS_PWR_DISABLE);
            }
        } else {
            mtcmos_resource.dsp++;
            if (mtcmos_resource.dsp == 1) {
                spm_control_mtcmos_internal(SPM_MTCMOS_DSP, SPM_MTCMOS_PWR_ENABLE);
            }
        }
        hal_nvic_restore_interrupt_mask_special(mask);
        return (mtcmos_resource.dsp);
    }

    if (mtcmos == SPM_MTCMOS_PERISYS) {
        if (ctrl == SPM_MTCMOS_PWR_DISABLE) {
            if (mtcmos_resource.perisys == 0) {
                spm_control_mtcmos_internal(SPM_MTCMOS_PERISYS, SPM_MTCMOS_PWR_DISABLE);
                hal_nvic_restore_interrupt_mask_special(mask);
                return 0;
            }
            mtcmos_resource.perisys--;
            if (mtcmos_resource.perisys == 0) {
                spm_control_mtcmos_internal(SPM_MTCMOS_PERISYS, SPM_MTCMOS_PWR_DISABLE);
            }
        } else {
            mtcmos_resource.perisys++;
            if (mtcmos_resource.perisys == 1) {
                spm_control_mtcmos_internal(SPM_MTCMOS_PERISYS, SPM_MTCMOS_PWR_ENABLE);
            }
        }
        hal_nvic_restore_interrupt_mask_special(mask);
        return (mtcmos_resource.perisys);
    }

    if (mtcmos == SPM_MTCMOS_VOW) {
        if (ctrl == SPM_MTCMOS_PWR_DISABLE) {
            if (mtcmos_resource.vow == 0) {
                spm_control_mtcmos_internal(SPM_MTCMOS_VOW, SPM_MTCMOS_PWR_DISABLE);
                hal_nvic_restore_interrupt_mask_special(mask);
                return 0;
            }
            mtcmos_resource.vow--;
            if (mtcmos_resource.vow == 0) {
                spm_control_mtcmos_internal(SPM_MTCMOS_VOW, SPM_MTCMOS_PWR_DISABLE);
            }
        } else {
            mtcmos_resource.vow++;
            if (mtcmos_resource.vow == 1) {
                spm_control_mtcmos_internal(SPM_MTCMOS_VOW, SPM_MTCMOS_PWR_ENABLE);
            }
        }
        hal_nvic_restore_interrupt_mask_special(mask);
        return (mtcmos_resource.vow);
    }

    if (mtcmos == SPM_MTCMOS_COLIAS_TOP) {
        if (ctrl == SPM_MTCMOS_PWR_DISABLE) {
            if (mtcmos_resource.colias_top == 0) {
                spm_control_mtcmos_internal(SPM_MTCMOS_COLIAS_TOP, SPM_MTCMOS_PWR_DISABLE);
                hal_nvic_restore_interrupt_mask_special(mask);
                return 0;
            }
            mtcmos_resource.colias_top--;
            if (mtcmos_resource.colias_top == 0) {
                spm_control_mtcmos_internal(SPM_MTCMOS_COLIAS_TOP, SPM_MTCMOS_PWR_DISABLE);
            }
        } else {
            mtcmos_resource.colias_top++;
            if (mtcmos_resource.colias_top == 1) {
                spm_control_mtcmos_internal(SPM_MTCMOS_COLIAS_TOP, SPM_MTCMOS_PWR_ENABLE);
            }
        }
        hal_nvic_restore_interrupt_mask_special(mask);
        return (mtcmos_resource.colias_top);
    }

    log_hal_msgid_info("spm_mtcmos_control is no work, because of error type of mtcmos\r\n", 0);
    return 0;
}

void spm_mask_wakeup_source(uint32_t wakeup_source)
{
    /* SPM Clock Force to 26M bar, *SPM_CLK_SW_CON &= ~(1 << 0) */
    //*SPM_CLK_SW_CON &= ~(1 << 0);

    if (wakeup_source == HAL_SLEEP_MANAGER_WAKEUP_SOURCE_ALL) {
        *SPM_CMSYS_WAKEUP_SOURCE_MASK = 0xFF;
    } else {
        *SPM_CMSYS_WAKEUP_SOURCE_MASK |= (1 << wakeup_source);
    }

}

void spm_unmask_wakeup_source(uint32_t wakeup_source)
{
    /* SPM Clock Force to 26M bar, *SPM_CLK_SW_CON &= ~(1 << 0) */
    //*SPM_CLK_SW_CON &= ~(1 << 0);

    if (wakeup_source == HAL_SLEEP_MANAGER_WAKEUP_SOURCE_ALL) {
        *SPM_CMSYS_WAKEUP_SOURCE_MASK = 0x00;
    } else {
        *SPM_CMSYS_WAKEUP_SOURCE_MASK &= ~(1 << wakeup_source);
    }
}

void spm_audio_lowpower_setting(spm_sleep_state_t sleep_state, spm_ctrl_t enable)
{

    if (sleep_state == SPM_STATE1) {
        if (enable == SPM_ENABLE) {
            spm_force_sleep_state(SPM_AUDIO_REQUEST, SPM_STATE1, SPM_ENABLE);
            /* CM4 notify DSP0 lock sleep , if CM4 have any audio request */
            *SPM_PCM_RESERVE2 |= 0x80000000; /* use bit31 */
        } else {
            spm_force_sleep_state(SPM_AUDIO_REQUEST, SPM_STATE1, SPM_DISABLE);
            /* CM4 notify DSP0 unlock sleep , if CM4 have not any audio request */
            *SPM_PCM_RESERVE2 &= 0x7FFFFFFF; /* use bit31 */
        }
        return;
    }

    if (sleep_state == SPM_STATE4) {
        if (enable == SPM_ENABLE) {
            spm_force_sleep_state(SPM_AUDIO_REQUEST, SPM_STATE4, SPM_ENABLE);
        } else {
            spm_force_sleep_state(SPM_AUDIO_REQUEST, SPM_STATE4, SPM_DISABLE);
        }
        return;
    }
}

static void spm_force_sleep_state_dbg(spm_request_t user, spm_sleep_state_t state, spm_ctrl_t enable)
{
    log_hal_msgid_info("[SLP] spm_force_sleep_state: caller=%d, sleep state=%d, sleep control=%d, lock sleep state status=0x%08x", 4, user, state, enable, *SPM_SPM_STATE_CONTROL_0);
}

void spm_force_sleep_state(spm_request_t user, spm_sleep_state_t state, spm_ctrl_t enable)
{
    static uint8_t resource_control[SPM_STATE_MAX];
    uint32_t mask;

    /* SPM Clock Force to 26M bar, *SPM_CLK_SW_CON &= ~(1 << 0) */
    //*SPM_CLK_SW_CON &= ~(1 << 0);

    hal_nvic_save_and_set_interrupt_mask(&mask);
    if (enable == SPM_ENABLE) {
        resource_control[state] |= (1 << user);
    } else {
        resource_control[state] &= ~(1 << user);
    }

    if (state == SPM_STATE1) {
        if (resource_control[state] == 0) {
            *SPM_SPM_STATE_CONTROL_0 &= 0xFFFFFFFE;
        } else {
            *SPM_SPM_STATE_CONTROL_0 |= 0x1;
        }
    } else if (state == SPM_STATE3) {
        if (resource_control[state] == 0) {
            *SPM_SPM_STATE_CONTROL_0 &= 0xFFFEFFFF;
        } else {
            *SPM_SPM_STATE_CONTROL_0 |= 0x10000;
        }
    } else if (state == SPM_STATE4) {
        if (resource_control[state] == 0) {
            *SPM_SPM_STATE_CONTROL_0 &= 0xFEFFFFFF;
        } else {
            *SPM_SPM_STATE_CONTROL_0 |= 0x1000000;
        }
    }

    hal_nvic_restore_interrupt_mask(mask);
    if (user != SPM_RTC) { // has asked RTC owner to add this log before calling this API
        spm_force_sleep_state_dbg(user, state, enable);
    }
}

void spm_force_on_pmic(spm_request_t spm_request, spm_ctrl_t enable)
{
    static uint8_t resource_control = 0;

    /* SPM Clock Force to 26M bar, *SPM_CLK_SW_CON &= ~(1 << 0) */
    //*SPM_CLK_SW_CON &= ~(1 << 0);

    if (enable == SPM_ENABLE) {
        resource_control |= (1 << spm_request);
    } else {
        resource_control &= ~(1 << spm_request);
    }

    if (resource_control == 0) {
        *SPM_SEQUENCER_32K_REG_0 &= 0xFFFFFEFF;       /* Unforce PMIC On */
    } else {
        *SPM_SEQUENCER_32K_REG_0 |= 0x100;            /* Force PMIC On */
    }
}

static void spm_scenario_flag_setting_dbg(spm_senario_t senario, spm_flag_t flag, spm_ctrl_t enable, uint8_t flag_val)
{
    log_hal_msgid_info("[SLP] spm_scenario_flag_setting: caller=%d, spm_flag=%d, flag_control=%d, flag_resource_control=0x%x", 4, senario, flag, enable, flag_val);
}

static void spm_scenario_flag_setting_internal(spm_senario_t senario, spm_flag_t flag, spm_ctrl_t enable)
{
    uint32_t mask;
    static uint8_t flag_resource_control[SPM_FLAG_MAX];

    hal_nvic_save_and_set_interrupt_mask(&mask);
    if(flag == SPM_IRRX_FLAG) {

        if(enable == SPM_ENABLE) {

            flag_resource_control[flag] |= (1 << senario);
            *SPM_DUMMY_REG_B = 0x1;   /* IRRX scenario on */

            //log_hal_msgid_info("[SLP] spm_scenario_flag_setting: SPM_IRRX_FLAG is enable!!\r\n", 0);
        } else {

            flag_resource_control[flag] &= ~(1 << senario);

            if(flag_resource_control[flag] == 0) {
                *SPM_DUMMY_REG_B = 0x0;   /* IRRX scenario off */
            }
        }

    } else if(flag == SPM_PERI_CONTROL_FLAG) {

        if(enable == SPM_ENABLE) {

            flag_resource_control[flag] |= (1 << senario);
            *(volatile uint32_t*)(0x420B00C8)  = 0x1;   /* perisys controlled by cpu */

            //log_hal_msgid_info("[SLP] spm_scenario_flag_setting: SPM_PERI_CONTROL_FLAG is enable!!\r\n", 0);
        } else {

            flag_resource_control[flag] &= ~(1 << senario);

            if(flag_resource_control[flag] == 0) {
                *(volatile uint32_t*)(0x420B00C8) = 0x0;   /* perisys controlled by spm */
            }
        }
    }

    hal_nvic_restore_interrupt_mask(mask);
    spm_scenario_flag_setting_dbg(senario, flag, enable, flag_resource_control[flag]);

}

void spm_scenario_flag_setting(spm_senario_t senario, spm_ctrl_t enable)
{

    static uint8_t senario_resource_control[SPM_SCENARIO_MAX] = {0};

    if(senario >= SPM_SCENARIO_MAX){
        //log_hal_msgid_info("[SLP] spm_scenario_flag_setting: senario is not support!!\r\n", 0);
        //log_hal_msgid_info("[SLP] spm_scenario_flag_setting: caller=%d, flag_control=%d", 2, senario, enable);
        assert(0);
        return;
    }

    if(senario_resource_control[senario] == enable){
        //log_hal_msgid_info("[SLP] spm_scenario_flag_setting: senario is double control!!\r\n", 0);
        //log_hal_msgid_info("[SLP] spm_scenario_flag_setting: caller=%d, flag_control=%d", 2, senario, enable);
        assert(0);
        return;
    }

    if(senario == SPM_IRRX_SCENARIO){
        if(enable == SPM_ENABLE){
            spm_scenario_flag_setting_internal(SPM_IRRX_SCENARIO, SPM_IRRX_FLAG, SPM_ENABLE);
            spm_scenario_flag_setting_internal(SPM_IRRX_SCENARIO, SPM_PERI_CONTROL_FLAG, SPM_ENABLE);
            senario_resource_control[senario] = enable;
        }else{
            spm_scenario_flag_setting_internal(SPM_IRRX_SCENARIO, SPM_IRRX_FLAG, SPM_DISABLE);
            spm_scenario_flag_setting_internal(SPM_IRRX_SCENARIO, SPM_PERI_CONTROL_FLAG, SPM_DISABLE);
            senario_resource_control[senario] = enable;
        }
        return;
    }
}

int spm_latency_time_checking(void)
{
    int latency_time_32k;
    float hw_buffer_time = 1; //ms
    float hw_buffer_time_32k = 0;
    float hw_buffer_time_freq = 32.768;
    float latency_time_max_ms = 8; /* MaximumIdleTime - DEEP_SLEEP_SW_BACKUP_RESTORE_TIME */
    float latency_time_min_ms = 2; /* Minimun of Sleep/Wakeup time */
    float latency_time_max_32k;
    float latency_time_min_32k;

    uint32_t xo_en_delay, osc_en_delay, pmu_en_delay, en_delay_max;

    uint32_t latency_time_check;
    uint32_t latency_time_error = 0xFFFFFFFF;

    log_hal_msgid_info("[spm_latency_time_checking] SPM_SEQUENCER_32K_REG_1 is 0x%08x", 1, *SPM_SEQUENCER_32K_REG_1);
    log_hal_msgid_info("[spm_latency_time_checking] SPM_SEQUENCER_32K_REG_2 is 0x%08x", 1, *SPM_SEQUENCER_32K_REG_2);
    log_hal_msgid_info("[spm_latency_time_checking] SPM_SEQUENCER_32K_REG_3 is 0x%08x", 1, *SPM_SEQUENCER_32K_REG_3);
    log_hal_msgid_info("[spm_latency_time_checking] SPM_SEQUENCER_32K_REG_4 is 0x%08x", 1, *SPM_SEQUENCER_32K_REG_4);

    osc_en_delay = ((*SPM_SEQUENCER_32K_REG_3 >> 0) & 0xFF);
    pmu_en_delay = ((*SPM_SEQUENCER_32K_REG_3 >> 8) & 0xFF);
    xo_en_delay = ((*SPM_SEQUENCER_32K_REG_3 >> 16) & 0xFF);
    en_delay_max = osc_en_delay;

    if(pmu_en_delay >= en_delay_max){
        en_delay_max = pmu_en_delay;
    }else if(xo_en_delay >= en_delay_max){
        en_delay_max = xo_en_delay;
    }

    hw_buffer_time_32k = (hw_buffer_time / (1 / (hw_buffer_time_freq)));
    latency_time_max_32k = (latency_time_max_ms / (1 / (hw_buffer_time_freq))) - 1; /* hw_latency_time_ms round up */
    latency_time_min_32k = (latency_time_min_ms / (1 / (hw_buffer_time_freq)));

    latency_time_check = (*SPM_SEQUENCER_32K_REG_1 + *SPM_SEQUENCER_32K_REG_2 + en_delay_max + *SPM_SEQUENCER_32K_REG_4);
    latency_time_32k = ((int)latency_time_check + (int)hw_buffer_time_32k);

    if(latency_time_32k < (int)latency_time_min_32k || latency_time_32k > (int)latency_time_max_32k ){
        log_hal_msgid_info("spm_latency_time_checking is error, max of latency time is %d in 32k", 1, (int)latency_time_max_32k);
        assert(0);
        return(latency_time_error);
    }

    log_hal_msgid_info("[spm_latency_time_checking] latency_time_32k is %d", 1, latency_time_32k);

    return(latency_time_32k);
}

void spm_debug_io(unsigned int debug_bus)
{

    /* SPM Clock Force to 26M bar, *SPM_CLK_SW_CON &= ~(1 << 0) */
    //*SPM_CLK_SW_CON &= ~(1 << 0);
    //Set GPIO
#if 0
    hal_pinmux_set_function(16, 10);
    hal_pinmux_set_function(33, 10);
    hal_pinmux_set_function(34, 10);
    hal_pinmux_set_function(35, 10);

    hal_pinmux_set_function(36, 10);
    hal_pinmux_set_function(37, 10);
    hal_pinmux_set_function(38, 10);
    hal_pinmux_set_function(39, 10);

    hal_pinmux_set_function(HAL_GPIO_40, 10);
    hal_pinmux_set_function(HAL_GPIO_41, 10);
    hal_pinmux_set_function(HAL_GPIO_42, 10);
    hal_pinmux_set_function(HAL_GPIO_43, 10);

    hal_pinmux_set_function(HAL_GPIO_44, 10);
    hal_pinmux_set_function(HAL_GPIO_45, 10);
    hal_pinmux_set_function(HAL_GPIO_14, 10);
    hal_pinmux_set_function(HAL_GPIO_15, 10);
#endif

    //*TOP_DEBUG(0xA2010008) = 0x14;
    *(volatile uint32_t *)(0x42010008) = 0x13;
    //*INFRA_CFG_DBGMON__AO_DBGMON_SEL(0xA2200030)  = 0x0
    *(volatile uint32_t *)(0x422D0030) = 0x0;

    //*SPM_DEBUG_CON(0xA21103D4)=0x1;
    *(volatile uint32_t *)(0x421403D4) = 0x1;
    //0xA21103D0
    //*SPM_SPM_DEBUG_SELECT = debug_bus;
    *(volatile uint32_t *)(0x421403D0) = debug_bus;

    log_hal_msgid_info("spm_debug_io SPM_SPM_DEBUG_SELECT=0x%x\r\n\r\n", 1, *SPM_SPM_DEBUG_SELECT);
}

/****************************************************************************************************************************/

void spm_check_debug_bus()
{
    spm_debug_io(0x43424342);

    unsigned int i = 0, delay = 0;

    /* SPM Clock Force to 26M bar, *SPM_CLK_SW_CON &= ~(1 << 0) */
    //*SPM_CLK_SW_CON &= ~(1 << 0);

    while (1) {
        *SPM_STATE_STATUS = i;
        for (delay = 0; delay < 512; delay++);
        if (i++ >= 512) {
            i = 0;
        }
    }
}

#define SPM_DVT 0
#if SPM_DVT
void spm_dvt_test_case_mtcmos()
{
    spm_debug_io(0x45444342);//check MTCMOS status
    /* SPM Clock Force to 26M bar, *SPM_CLK_SW_CON &= ~(1 << 0) */
    //*SPM_CLK_SW_CON &= ~(1 << 0);
#if 1
    while (1) {
        *SPM_STATE_STATUS = 1;
        hal_gpt_delay_us(100);

        *SPM_STATE_STATUS = 2;
        spm_control_mtcmos_internal(SPM_MTCMOS_CONN_TOP_ON, SPM_MTCMOS_PWR_DISABLE);
        hal_gpt_delay_us(100);
        *SPM_STATE_STATUS = 3;
        spm_control_mtcmos_internal(SPM_MTCMOS_CONN_TOP_ON, SPM_MTCMOS_PWR_ENABLE);
        hal_gpt_delay_us(100);

        *SPM_STATE_STATUS = 4;
        spm_control_mtcmos_internal(SPM_MTCMOS_CONN_TOP_OFF, SPM_MTCMOS_PWR_DISABLE);
        hal_gpt_delay_us(100);
        *SPM_STATE_STATUS = 5;
        spm_control_mtcmos_internal(SPM_MTCMOS_CONN_TOP_OFF, SPM_MTCMOS_PWR_ENABLE);
        hal_gpt_delay_us(100);

        *SPM_STATE_STATUS = 6;
        spm_control_mtcmos_internal(SPM_MTCMOS_AUDIO_ANC, SPM_MTCMOS_PWR_DISABLE);
        hal_gpt_delay_us(100);
        spm_control_mtcmos_internal(SPM_MTCMOS_AUDIO_HS, SPM_MTCMOS_PWR_DISABLE);
        hal_gpt_delay_us(100);
        spm_control_mtcmos_internal(SPM_MTCMOS_AUDIO_SYS, SPM_MTCMOS_PWR_DISABLE);
        hal_gpt_delay_us(100);
        *SPM_STATE_STATUS = 7;
        spm_control_mtcmos_internal(SPM_MTCMOS_AUDIO_SYS, SPM_MTCMOS_PWR_ENABLE);
        hal_gpt_delay_us(100);
        spm_control_mtcmos_internal(SPM_MTCMOS_AUDIO_HS, SPM_MTCMOS_PWR_DISABLE);
        hal_gpt_delay_us(100);
        spm_control_mtcmos_internal(SPM_MTCMOS_AUDIO_ANC, SPM_MTCMOS_PWR_DISABLE);

        *SPM_STATE_STATUS = 8;
        spm_control_mtcmos_internal(SPM_MTCMOS_DSP, SPM_MTCMOS_PWR_DISABLE);
        hal_gpt_delay_us(100);
        *SPM_STATE_STATUS = 9;
        spm_control_mtcmos_internal(SPM_MTCMOS_DSP, SPM_MTCMOS_PWR_ENABLE);
        hal_gpt_delay_us(100);

        *SPM_STATE_STATUS = 0xA;
        spm_control_mtcmos_internal(SPM_MTCMOS_PERISYS, SPM_MTCMOS_PWR_DISABLE);
        hal_gpt_delay_us(100);
        *SPM_STATE_STATUS = 0xB;
        spm_control_mtcmos_internal(SPM_MTCMOS_PERISYS, SPM_MTCMOS_PWR_ENABLE);
        hal_gpt_delay_us(100);

        *SPM_STATE_STATUS = 0xC;
        spm_control_mtcmos_internal(SPM_MTCMOS_VOW, SPM_MTCMOS_PWR_DISABLE);
        hal_gpt_delay_us(100);
        *SPM_STATE_STATUS = 0xD;
        spm_control_mtcmos_internal(SPM_MTCMOS_VOW, SPM_MTCMOS_PWR_ENABLE);
        hal_gpt_delay_us(100);
    }
#endif
}

void HW_GPT_callback(void)
{
    //log_hal_msgid_info("HW GPT callback!!", 0);
    hal_gpt_stop_timer(HAL_GPT_7); /* stop timer clear gpt irq */
    hal_gpt_start_timer_us(HAL_GPT_7, 1000000, HAL_GPT_TIMER_TYPE_ONE_SHOT);
}

uint32_t SW_GPT_Handler;
void SW_GPT_callback(void)
{

    log_hal_msgid_info("SW GPT callback!!", 0);
    hal_gpt_sw_stop_timer_ms(SW_GPT_Handler); /* stop timer clear gpt irq */
    hal_gpt_sw_start_timer_ms(SW_GPT_Handler, 2000, SW_GPT_callback, NULL);

}

void spm_dvt_test_case_deep_sleep(void)
{
    uint32_t mask;
    uint32_t count = 0;
    int i;

    for (i = 0; i < 75; i++) {
        //hal_nvic_disable_irq(i);
        if (hal_nvic_get_pending_irq(i) == 1) {
            log_hal_msgid_info("pending_irq:%d\r\n", 1, i);
            hal_nvic_clear_pending_irq(i);
        }
    }

    hal_nvic_disable_irq(12);
    hal_nvic_disable_irq(21);

    spm_debug_io(0x41404342);


    ///***    CMSYS sleep backup/restore test setting    ***/
    *SPM_CMSYS_WAKEUP_SOURCE_MASK = 0xFFFFFFFE;
    *SPM_DSP_WAKEUP_SOURCE_MASK = 0xFFFFFFFF;
    *SPM_IGNORE_CPU_ACTIVE |= 0x100;    //IGNORE DSP ACTIVE
    /***  CMSYS sleep backup/restore test setting end  ***/

    ///***    DSP sleep backup/restore test setting    ***/
    //*SPM_CMSYS_WAKEUP_SOURCE_MASK = 0xFFFFFFFF;
    //*SPM_DSP_WAKEUP_SOURCE_MASK = 0xFFFFFFFE;
    //*SPM_IGNORE_CPU_ACTIVE = 0x0;    //IGNORE DSP ACTIVE
    ///***  DSP sleep backup/restore test setting end  ***/

    //hal_gpt_init(HAL_GPT_7);
    //hal_gpt_register_callback(HAL_GPT_7, HW_GPT_callback, NULL);

    hal_gpt_sw_get_timer(&SW_GPT_Handler);

    log_hal_msgid_info("sleep flow start test\r\n", 0);

    while (1) {

        //hal_gpt_start_timer_ms(HAL_GPT_7, 1000000, HAL_GPT_TIMER_TYPE_ONE_SHOT); // 32k clk
        hal_gpt_sw_start_timer_ms(SW_GPT_Handler, 3000, SW_GPT_callback, NULL); //32k clk

        hal_nvic_clear_pending_irq(29); //GPT_IRQn
        hal_nvic_clear_pending_irq(30); //GPT_SEC_IRQn
        *SPM_CONN_AUDIO_ABB_XO_SIDEBAND = 0;        //for sleep test, need BT or Audio Control.
        hal_nvic_save_and_set_interrupt_mask(&mask);
        __asm volatile("cpsid i");
        log_hal_msgid_info("sleep flow enter sleep\r\n", 0);
        hal_sleep_manager_enter_sleep_mode(HAL_SLEEP_MODE_SLEEP);
        log_hal_msgid_info("sleep flow wakeup\r\n", 0);
        __asm volatile("cpsie i");
        hal_nvic_restore_interrupt_mask(mask);
        *SPM_CONN_AUDIO_ABB_XO_SIDEBAND = 0x101;    //for sleep test, need BT or Audio Control.

        if (count++ > 20) {
            while (1);
        }
    }
}

int spm_dvt_test_case_select_value = 2;
void spm_dvt_test_case_select(void)
{
    while (1) {
        if (spm_dvt_test_case_select_value == 0) {
            spm_check_debug_bus();
        }
        if (spm_dvt_test_case_select_value == 1) {
            spm_dvt_test_case_mtcmos();
        }
        if (spm_dvt_test_case_select_value == 2) {
            //*SPM_SKIP_SFC_EMI_TASK |= 1;
            //*SPM_SKIP_SFC_EMI_TASK |= (1 << 8);
            *SPM_CMSYS_WAKEUP_SOURCE_MASK = 0xFFFFFFFE; //Only unmask GPT wakeup_source
            spm_dvt_test_case_deep_sleep();
        }
        /*
        if(spm_dvt_test_case_select_value == 3){
            *SPM_SKIP_SFC_EMI_TASK |= 1;
            *SPM_DSP_WAKEUP_SOURCE_MASK = 0xFFFFFFFE; //Only unmask GPT wakeup_source
             spm_dvt_test_case_deep_sleep_wi_CPU_off_but_UART_is_working();
        }*/

    }
}
#endif /* SPM_DVT */
/****************************************************************************************************************************/

static void spm_mtcmos_audio_sys_on()
{

    /* SPM Clock Force to 26M bar, *SPM_CLK_SW_CON &= ~(1 << 0) */
    //*SPM_CLK_SW_CON &= ~(1 << 0);

    if ((*SPM_PWR_STATUS & 0x10) != 0) {
        // log_hal_msgid_info("spm_mtcmos_audio_sys is already on\r\n", 0);
        return;
    }

    /*TINFO = " --- AUDIO_SYS power on by CM33 API "*/
    //*AUDIO_SYS_PWR_CON = 0x12; sleep
    *SPM_AUDIO_SYS_PWR_CON = 0x16; // [2]: pwr_on = 1
    hal_gpt_delay_us(1); // 1us
    *SPM_AUDIO_SYS_PWR_CON = 0x1E; // [3]: pwr_on_2nd = 1
    hal_gpt_delay_us(1); // 1us

// --- AUDIO SRAM begin ------
    *SPM_AUDIO_SYS_AFE_DL_UL_G_P_CONTROL_1  = 0x7F007F00; // [30:24]:MEM_ISO_EN [22:16]:ISOINTB [14:8]:SLEEPB [6:0]:PD
    *SPM_AUDIO_SYS_ASRC_CONTROL_1           = 0x07000403; // [26:24]:MEM_ISO_EN [18:16]:ISOINTB [10:8]:SLEEPB [2:0]:PD
    *SPM_AUDIO_SYS_ASRC_CONTROL_1           = 0x07000700; // [26:24]:MEM_ISO_EN [18:16]:ISOINTB [10:8]:SLEEPB [2:0]:PD
    *SPM_AUDIO_SYS_AFE_MEMIF_CONTROL_1      = 0x01000100; // [24:24]:MEM_ISO_EN [16:16]:ISOINTB [8:8]:SLEEPB [0:0]:PD
    hal_gpt_delay_us(2); // 2us

    *SPM_AUDIO_SYS_AFE_DL_UL_G_P_CONTROL_1  = 0x7F7F7F00; // [30:24]:MEM_ISO_EN [22:16]:ISOINTB [14:8]:SLEEPB [6:0]:PD
    *SPM_AUDIO_SYS_ASRC_CONTROL_1           = 0x07070700; // [26:24]:MEM_ISO_EN [18:16]:ISOINTB [10:8]:SLEEPB [2:0]:PD
    *SPM_AUDIO_SYS_AFE_MEMIF_CONTROL_1      = 0x01010100; // [24:24]:MEM_ISO_EN [16:16]:ISOINTB [8:8]:SLEEPB [0:0]:PD
    hal_gpt_delay_us(1); // 1us

// --- AUDIO SRAM end ------
    *SPM_AUDIO_SYS_PWR_CON = 0xE;   // [4]: clk_dis = 0
    hal_gpt_delay_us(1); // 1us
    *SPM_AUDIO_SYS_PWR_CON = 0x1E;  // [4]: clk_dis = 1
    hal_gpt_delay_us(1); // 1us
    *SPM_AUDIO_SYS_PWR_CON = 0x1C;  // [4]: clk_dis = 1, iso = 0
    hal_gpt_delay_us(1); // 1us
    *SPM_AUDIO_SYS_PWR_CON = 0x1D;  // [0]: rstb = 1
    hal_gpt_delay_us(1); // 1us

// --- AUDIO SRAM MEM_ISO_EN begin ------
    *SPM_AUDIO_SYS_AFE_DL_UL_G_P_CONTROL_1  = 0x007F7F00; // [25:24]:MEM_ISO_EN [17:16]:ISOINTB [9:8]:SLEEPB [1:0]:PD
    *SPM_AUDIO_SYS_ASRC_CONTROL_1           = 0x00070700; // [26:24]:MEM_ISO_EN [18:16]:ISOINTB [10:8]:SLEEPB [2:0]:PD
    *SPM_AUDIO_SYS_AFE_MEMIF_CONTROL_1      = 0x00010100; // [24:24]:MEM_ISO_EN [16:16]:ISOINTB [8:8]:SLEEPB [0:0]:PD
    hal_gpt_delay_us(1); // 1us

// --- AUDIO SRAM end ------

    *SPM_AUDIO_SYS_PWR_CON = 0xD;   // [4]: clk_dis = 0
    hal_gpt_delay_us(1); // 1us

    //turn AUDIO_SYS protect_en=0
    *AUDIO_SYS_TOP_PROT_EN = 0x0;
    //wait AUDIO_SYS protect ready=0
    while (*AUDIO_SYS_TOP_PROT_RDY != 0x0);

}

static void spm_mtcmos_audio_sys_off(void)
{

    /* SPM Clock Force to 26M bar, *SPM_CLK_SW_CON &= ~(1 << 0) */
    //*SPM_CLK_SW_CON &= ~(1 << 0);

    if ((*SPM_PWR_STATUS & 0x10) == 0) {
        // log_hal_msgid_info("spm_mtcmos_audio_sys is already off\r\n", 0);
        return;
    }

    //turn AUDIO_SYS protect_en=1
    *AUDIO_SYS_TOP_PROT_EN = 0x1;
    //wait AUDIO_SYS protect ready=1
    while (*AUDIO_SYS_TOP_PROT_RDY != 0x1);

    /*TINFO = " --- AUDIO_SYS power down by CM33 API "*/
    *SPM_AUDIO_SYS_PWR_CON = 0x1D; // [4]: clk_dis = 1
    hal_gpt_delay_us(1); // 1us
    *SPM_AUDIO_SYS_PWR_CON = 0x1F; // [1]: iso = 1
    hal_gpt_delay_us(1); // 1us


//// --- AUDIO SRAM Power Down begin ------
    *SPM_AUDIO_SYS_AFE_DL_UL_G_P_CONTROL_1  = 0x7F7F7F00; // [30:24]:MEM_ISO_EN [22:16]:ISOINTB [14:8]:SLEEPB [6:0]:PD
    *SPM_AUDIO_SYS_ASRC_CONTROL_1           = 0x07070700; // [26:24]:MEM_ISO_EN [18:16]:ISOINTB [10:8]:SLEEPB [2:0]:PD
    *SPM_AUDIO_SYS_AFE_MEMIF_CONTROL_1      = 0x01010100; // [24:24]:MEM_ISO_EN [16:16]:ISOINTB [8:8]:SLEEPB [0:0]:PD
    hal_gpt_delay_us(1); // 1us

    *SPM_AUDIO_SYS_AFE_DL_UL_G_P_CONTROL_1  = 0x7F007F00; // [30:24]:MEM_ISO_EN [22:16]:ISOINTB [14:8]:SLEEPB [6:0]:PD
    *SPM_AUDIO_SYS_ASRC_CONTROL_1           = 0x07000700; // [26:24]:MEM_ISO_EN [18:16]:ISOINTB [10:8]:SLEEPB [2:0]:PD
    *SPM_AUDIO_SYS_AFE_MEMIF_CONTROL_1      = 0x01000100; // [24:24]:MEM_ISO_EN [16:16]:ISOINTB [8:8]:SLEEPB [0:0]:PD
    hal_gpt_delay_us(1); // wait isointb to sleepb  > 1us


    *SPM_AUDIO_SYS_AFE_DL_UL_G_P_CONTROL_1  = 0x7F00007F; // [30:24]:MEM_ISO_EN [22:16]:ISOINTB [14:8]:SLEEPB [6:0]:PD
    *SPM_AUDIO_SYS_ASRC_CONTROL_1           = 0x07000403; // [26:24]:MEM_ISO_EN [18:16]:ISOINTB [10:8]:SLEEPB [2:0]:PD
    *SPM_AUDIO_SYS_ASRC_CONTROL_1           = 0x07000007; // [26:24]:MEM_ISO_EN [18:16]:ISOINTB [10:8]:SLEEPB [2:0]:PD
    *SPM_AUDIO_SYS_AFE_MEMIF_CONTROL_1      = 0x01000001; // [24:24]:MEM_ISO_EN [16:16]:ISOINTB [8:8]:SLEEPB [0:0]:PD
    hal_gpt_delay_us(1); // 1us

//// --- AUDIO SRAM end Power Down------

    *SPM_AUDIO_SYS_PWR_CON = 0x1E; // [0]: rstb = 0
    hal_gpt_delay_us(1); // 1us

    *SPM_AUDIO_SYS_PWR_CON = 0x1A; // [2]: pwr_on = 0
    hal_gpt_delay_us(1); // 1us

    *SPM_AUDIO_SYS_PWR_CON = 0x12; // [3]: pwr_on_2nd = 0
    hal_gpt_delay_us(1); // 1us

}

static void spm_mtcmos_audio_anc_on(void)
{

    /* SPM Clock Force to 26M bar, *SPM_CLK_SW_CON &= ~(1 << 0) */
    //*SPM_CLK_SW_CON &= ~(1 << 0);

    if ((*SPM_PWR_STATUS & 0x20) != 0) {
        // log_hal_msgid_info("spm_mtcmos_audio_anc is already on\r\n", 0);
        return;
    }

    /*TINFO = " --- AUDIO_ANC power on by CM33 API "*/
    //*AUDIO_ANC_PWR_CON = 0x12; sleep
    *SPM_AUDIO_ANC_PWR_CON = 0x16; // [2]: pwr_on = 1
    hal_gpt_delay_us(1); // 1us
    *SPM_AUDIO_ANC_PWR_CON = 0x1E; // [3]: pwr_on_2nd = 1
    hal_gpt_delay_us(1); // 1us


    // --- AUDIO SRAM begin ------
    *SPM_AUDIO_ANC_BIQUAD_CONTROL_1  = 0x3F00201F; // [29:24]:MEM_ISO_EN [21:16]:ISOINTB [13:8]:SLEEPB [5:0]:PD
    *SPM_AUDIO_ANC_BIQUAD_CONTROL_1  = 0x3F00300F; // [29:24]:MEM_ISO_EN [21:16]:ISOINTB [13:8]:SLEEPB [5:0]:PD
    *SPM_AUDIO_ANC_BIQUAD_CONTROL_1  = 0x3F003807; // [29:24]:MEM_ISO_EN [21:16]:ISOINTB [13:8]:SLEEPB [5:0]:PD
    *SPM_AUDIO_ANC_BIQUAD_CONTROL_1  = 0x3F003C03; // [29:24]:MEM_ISO_EN [21:16]:ISOINTB [13:8]:SLEEPB [5:0]:PD
    *SPM_AUDIO_ANC_BIQUAD_CONTROL_1  = 0x3F003E01; // [29:24]:MEM_ISO_EN [21:16]:ISOINTB [13:8]:SLEEPB [5:0]:PD
    *SPM_AUDIO_ANC_BIQUAD_CONTROL_1  = 0x3F003F00; // [29:24]:MEM_ISO_EN [21:16]:ISOINTB [13:8]:SLEEPB [5:0]:PD

    *SPM_AUDIO_ANC_FIR_CONTROL_1     = 0x0F000C03; // [27:24]:MEM_ISO_EN [19:16]:ISOINTB [11:8]:SLEEPB [3:0]:PD
    *SPM_AUDIO_ANC_FIR_CONTROL_1     = 0x0F000F00; // [27:24]:MEM_ISO_EN [19:16]:ISOINTB [11:8]:SLEEPB [3:0]:PD
    hal_gpt_delay_us(2); // 2us


    *SPM_AUDIO_ANC_BIQUAD_CONTROL_1  = 0x3F3F3F00; // [29:24]:MEM_ISO_EN [21:16]:ISOINTB [13:8]:SLEEPB [5:0]:PD
    *SPM_AUDIO_ANC_FIR_CONTROL_1     = 0x0F0F0F00; // [27:24]:MEM_ISO_EN [19:16]:ISOINTB [11:8]:SLEEPB [3:0]:PD
    hal_gpt_delay_us(1); // 1us


    // --- AUDIO SRAM end ------
    *SPM_AUDIO_ANC_PWR_CON = 0xE;   // [4]: clk_dis = 0
    hal_gpt_delay_us(1); // 1us
    *SPM_AUDIO_ANC_PWR_CON = 0x1E;  // [4]: clk_dis = 1
    hal_gpt_delay_us(1); // 1us
    *SPM_AUDIO_ANC_PWR_CON = 0x1C;  // [4]: clk_dis = 1, iso = 0
    hal_gpt_delay_us(1); // 1us
    *SPM_AUDIO_ANC_PWR_CON = 0x1D;  // [0]: rstb = 1
    hal_gpt_delay_us(1); // 1us

    // --- AUDIO SRAM MEM_ISO_EN begin ------
    *SPM_AUDIO_ANC_BIQUAD_CONTROL_1  = 0x003F3F00; // [29:24]:MEM_ISO_EN [21:16]:ISOINTB [13:8]:SLEEPB [5:0]:PD
    *SPM_AUDIO_ANC_FIR_CONTROL_1     = 0x000F0F00; // [27:24]:MEM_ISO_EN [19:16]:ISOINTB [11:8]:SLEEPB [3:0]:PD
    hal_gpt_delay_us(1); // 1us

// --- AUDIO SRAM end ------

    *SPM_AUDIO_ANC_PWR_CON = 0xD;   // [4]: clk_dis = 0
    hal_gpt_delay_us(1); // 1us

    //turn AUDIO_ANC protect_en=0
    *AUDIO_ANC_TOP_PROT_EN = 0x0;
    //wait AUDIO_ANC protect ready=0
    while (*AUDIO_ANC_TOP_PROT_RDY != 0x0);
}

static void spm_mtcmos_audio_anc_off(void)
{

    /* SPM Clock Force to 26M bar, *SPM_CLK_SW_CON &= ~(1 << 0) */
    //*SPM_CLK_SW_CON &= ~(1 << 0);

    if ((*SPM_PWR_STATUS & 0x20) == 0) {
        // log_hal_msgid_info("spm_mtcmos_audio_anc is already off\r\n", 0);
        return;
    }

    //turn AUDIO_ANC protect_en=1
    *AUDIO_ANC_TOP_PROT_EN = 0x1;
    //wait AUDIO_ANC protect ready=1
    while (*AUDIO_ANC_TOP_PROT_RDY != 0x1);

    /*TINFO = " --- AUDIO_ANC power down by CM33 API "*/
    *SPM_AUDIO_ANC_PWR_CON = 0x1D; // [4]: clk_dis = 1
    hal_gpt_delay_us(1); // 1us
    *SPM_AUDIO_ANC_PWR_CON = 0x1F; // [1]: iso = 1
    hal_gpt_delay_us(1); // 1us

//// --- AUDIO SRAM Power Down begin ------
    *SPM_AUDIO_ANC_BIQUAD_CONTROL_1  = 0x3F3F3F00; // [29:24]:MEM_ISO_EN [21:16]:ISOINTB [13:8]:SLEEPB [5:0]:PD
    *SPM_AUDIO_ANC_FIR_CONTROL_1     = 0x0F0F0F00; // [27:24]:MEM_ISO_EN [19:16]:ISOINTB [11:8]:SLEEPB [3:0]:PD
    hal_gpt_delay_us(1); // 1us

    *SPM_AUDIO_ANC_BIQUAD_CONTROL_1  = 0x3F003F00; // [29:24]:MEM_ISO_EN [21:16]:ISOINTB [13:8]:SLEEPB [5:0]:PD
    *SPM_AUDIO_ANC_FIR_CONTROL_1     = 0x0F000F00; // [27:24]:MEM_ISO_EN [19:16]:ISOINTB [11:8]:SLEEPB [3:0]:PD
    hal_gpt_delay_us(1); // 1us wait isointb to sleepb  > 1us

    *SPM_AUDIO_ANC_BIQUAD_CONTROL_1  = 0x3F003E01; // [29:24]:MEM_ISO_EN [21:16]:ISOINTB [13:8]:SLEEPB [5:0]:PD
    *SPM_AUDIO_ANC_BIQUAD_CONTROL_1  = 0x3F003C03; // [29:24]:MEM_ISO_EN [21:16]:ISOINTB [13:8]:SLEEPB [5:0]:PD
    *SPM_AUDIO_ANC_BIQUAD_CONTROL_1  = 0x3F003807; // [29:24]:MEM_ISO_EN [21:16]:ISOINTB [13:8]:SLEEPB [5:0]:PD
    *SPM_AUDIO_ANC_BIQUAD_CONTROL_1  = 0x3F00300F; // [29:24]:MEM_ISO_EN [21:16]:ISOINTB [13:8]:SLEEPB [5:0]:PD
    *SPM_AUDIO_ANC_BIQUAD_CONTROL_1  = 0x3F00201F; // [29:24]:MEM_ISO_EN [21:16]:ISOINTB [13:8]:SLEEPB [5:0]:PD
    *SPM_AUDIO_ANC_BIQUAD_CONTROL_1  = 0x3F00003F; // [29:24]:MEM_ISO_EN [21:16]:ISOINTB [13:8]:SLEEPB [5:0]:PD

    *SPM_AUDIO_ANC_FIR_CONTROL_1     = 0x0F000C03; // [27:24]:MEM_ISO_EN [19:16]:ISOINTB [11:8]:SLEEPB [3:0]:PD
    *SPM_AUDIO_ANC_FIR_CONTROL_1     = 0x0F00000F; // [27:24]:MEM_ISO_EN [19:16]:ISOINTB [11:8]:SLEEPB [3:0]:PD
    hal_gpt_delay_us(1); // 1us

//// --- AUDIO SRAM end Power Down------

    *SPM_AUDIO_ANC_PWR_CON = 0x1E; // [0]: rstb = 0
    hal_gpt_delay_us(1); // 1us
    *SPM_AUDIO_ANC_PWR_CON = 0x1A; // [2]: pwr_on = 0
    hal_gpt_delay_us(1); // 1us
    *SPM_AUDIO_ANC_PWR_CON = 0x12; // [3]: pwr_on_2nd = 0
    hal_gpt_delay_us(1); // 1us
}

static void spm_mtcmos_audio_hs_on(void)
{

    /* SPM Clock Force to 26M bar, *SPM_CLK_SW_CON &= ~(1 << 0) */
    //*SPM_CLK_SW_CON &= ~(1 << 0);

    if ((*SPM_PWR_STATUS & 0x40) != 0) {
        // log_hal_msgid_info("spm_mtcmos_audio_hs is already on\r\n", 0);
        return;
    }

    /*TINFO = " --- AUDIO_HS power on by CM33 API "*/
    //*AUDIO_HS_PWR_CON = 0x12; sleep
    *SPM_AUDIO_HS_PWR_CON = 0x16; // [2]: pwr_on = 1
    hal_gpt_delay_us(1); // 1us
    *SPM_AUDIO_HS_PWR_CON = 0x1E; // [3]: pwr_on_2nd = 1
    hal_gpt_delay_us(1); // 1us

    // --- AUDIO SRAM begin ------


    // --- AUDIO SRAM end ------
    *SPM_AUDIO_HS_PWR_CON = 0xE;   // [4]: clk_dis = 0
    hal_gpt_delay_us(1); // 1us
    *SPM_AUDIO_HS_PWR_CON = 0x1E;  // [4]: clk_dis = 1
    hal_gpt_delay_us(1); // 1us
    *SPM_AUDIO_HS_PWR_CON = 0x1C;  // [4]: clk_dis = 1, iso = 0
    hal_gpt_delay_us(1); // 1us
    *SPM_AUDIO_HS_PWR_CON = 0x1D;  // [0]: rstb = 1
    hal_gpt_delay_us(1); // 1us

// --- AUDIO SRAM MEM_ISO_EN begin ------


// --- AUDIO SRAM end ------

    *SPM_AUDIO_HS_PWR_CON = 0xD;   // [4]: clk_dis = 0
    hal_gpt_delay_us(1); // 1us

    //turn AUDIO_HS protect_en=0
    *AUDIO_HS_TOP_PROT_EN = 0x0;
    //wait AUDIO_HS protect ready=0
    while (*AUDIO_HS_TOP_PROT_RDY != 0x0);

}

static void spm_mtcmos_audio_hs_off(void)
{

    /* SPM Clock Force to 26M bar, *SPM_CLK_SW_CON &= ~(1 << 0) */
    //*SPM_CLK_SW_CON &= ~(1 << 0);

    if ((*SPM_PWR_STATUS & 0x40) == 0) {
        // log_hal_msgid_info("spm_mtcmos_audio_hs is already off\r\n", 0);
        return;
    }

    //turn AUDIO_HS protect_en=1
    *AUDIO_HS_TOP_PROT_EN = 0x1;
    //wait AUDIO_HS protect ready=1
    while (*AUDIO_HS_TOP_PROT_RDY != 0x1);

    /*TINFO = " --- AUDIO_HS power down by CM33 API "*/
    *SPM_AUDIO_HS_PWR_CON = 0x1D; // [4]: clk_dis = 1
    hal_gpt_delay_us(1); // 1us
    *SPM_AUDIO_HS_PWR_CON = 0x1F; // [1]: iso = 1
    hal_gpt_delay_us(1); // 1us

//// --- AUDIO SRAM Power Down begin ------


//// --- AUDIO SRAM end Power Down------

    *SPM_AUDIO_HS_PWR_CON = 0x1E; // [0]: rstb = 0
    hal_gpt_delay_us(1); // 1us
    *SPM_AUDIO_HS_PWR_CON = 0x1A; // [2]: pwr_on = 0
    hal_gpt_delay_us(1); // 1us
    *SPM_AUDIO_HS_PWR_CON = 0x12; // [3]: pwr_on_2nd = 0
    hal_gpt_delay_us(1); // 1us
}

static void spm_mtcmos_conn_top_on_on(void)
{

    /* SPM Clock Force to 26M bar, *SPM_CLK_SW_CON &= ~(1 << 0) */
    //*SPM_CLK_SW_CON &= ~(1 << 0);

    if ((*SPM_PWR_STATUS & 0x4) != 0) {
        // log_hal_msgid_info("spm_mtcmos_conn_top_on is already on\r\n", 0);
        return;
    }

    /*TINFO = " --- CONN_TOP_ON power on API "*/
    //*CONN_TOP_ON_PWR_CON = 0x12; sleep
    *SPM_CONN_TOP_ON_PWR_CON = 0x16; // [2]: pwr_on = 1
    hal_gpt_delay_us(1); // 1us
    *SPM_CONN_TOP_ON_PWR_CON = 0x1E; // [3]: pwr_on_2nd = 1
    hal_gpt_delay_us(1); // 1us

// --- CONN_TOP_ON SRAM begin ------

// --- CONN_TOP_ON SRAM end ------
    *SPM_CONN_TOP_ON_PWR_CON = 0xE;   // [4]: clk_dis = 0
    hal_gpt_delay_us(1); // 1us
    *SPM_CONN_TOP_ON_PWR_CON = 0x1E;  // [4]: clk_dis = 1
    hal_gpt_delay_us(1); // 1us
    *SPM_CONN_TOP_ON_PWR_CON = 0x1C;  // [4]: clk_dis = 1, iso = 0
    hal_gpt_delay_us(1); // 1us
    *SPM_CONN_TOP_ON_PWR_CON = 0x1D;  // [0]: rstb = 1
    hal_gpt_delay_us(1); // 1us
    *SPM_CONN_TOP_ON_PWR_CON = 0xD;   // [4]: clk_dis = 0
    hal_gpt_delay_us(1); // 1us

    //turn CONN_TOP_OFF protect_en=0
    *CONNSYS_ON_PROT_EN = 0x0;
    //wait CONN_TOP_OFF protect ready=0
    while (*CONNSYS_ON_PROT_RDY != 0x0);
}

static void spm_mtcmos_conn_top_on_off(void)
{

    /* SPM Clock Force to 26M bar, *SPM_CLK_SW_CON &= ~(1 << 0) */
    //*SPM_CLK_SW_CON &= ~(1 << 0);

    if ((*SPM_PWR_STATUS & 0x4) == 0) {
        // log_hal_msgid_info("spm_mtcmos_conn_top_on is already off\r\n", 0);
        return;
    }

    //turn CONN_TOP_OFF protect_en=1
    *CONNSYS_ON_PROT_EN = 0x1;
    //wait CONN_TOP_OFF protect ready=1
    while (*CONNSYS_ON_PROT_RDY != 0x1);

    /*TINFO = " --- CONN_TOP_ON power down API "*/
    *SPM_CONN_TOP_ON_PWR_CON = 0x1D; // [4]: clk_dis = 1
    hal_gpt_delay_us(1); // 1us

    *SPM_CONN_TOP_ON_PWR_CON = 0x1F; // [1]: iso = 1
    hal_gpt_delay_us(1); // 1us

//// --- CONN_TOP_ON SRAM Power Down begin ------

//// --- CONN_TOP_ON SRAM end Power Down------

    *SPM_CONN_TOP_ON_PWR_CON = 0x1E; // [0]: rstb = 0
    hal_gpt_delay_us(1); // 1us

    *SPM_CONN_TOP_ON_PWR_CON = 0x1A; // [2]: pwr_on = 0
    hal_gpt_delay_us(1); // 1us

    *SPM_CONN_TOP_ON_PWR_CON = 0x12; // [3]: pwr_on_2nd = 0
    hal_gpt_delay_us(1); // 1us
}

static void spm_mtcmos_conn_top_off_on(void)
{

    /* SPM Clock Force to 26M bar, *SPM_CLK_SW_CON &= ~(1 << 0) */
    //*SPM_CLK_SW_CON &= ~(1 << 0);

    if ((*SPM_PWR_STATUS & 0x8) != 0) {
        // log_hal_msgid_info("spm_mtcmos_conn_top_off is already on\r\n", 0);
        return;
    }

    //=======Workaroud start
    //turn CONN_TOP_OFF protect_en=1
    *CONNSYS_OFF_PROT_EN = 0x1;
    //wait CONN_TOP_OFF protect ready=1
    while (*CONNSYS_OFF_PROT_RDY != 0x1);
    //=======Workaroud end

    /*TINFO = " --- CONN_TOP_OFF power on "*/
    //*CONN_TOP_OFF_PWR_CON = 0x12; sleep
    *SPM_CONN_TOP_OFF_PWR_CON = 0x16; // [2]: pwr_on = 1
    hal_gpt_delay_us(1); // 1us

    *SPM_CONN_TOP_OFF_PWR_CON = 0x1E; // [3]: pwr_on_2nd = 1
    hal_gpt_delay_us(1); // 1us

// --- CONN_TOP_OFF SRAM begin ------

// --- CONN_TOP_OFF SRAM end ------
    *SPM_CONN_TOP_OFF_PWR_CON = 0xE;   // [4]: clk_dis = 0
    hal_gpt_delay_us(1); // 1us

    *SPM_CONN_TOP_OFF_PWR_CON = 0x1E;  // [4]: clk_dis = 1
    hal_gpt_delay_us(1); // 1us

    *SPM_CONN_TOP_OFF_PWR_CON = 0x1C;  // [4]: clk_dis = 1, iso = 0
    hal_gpt_delay_us(1); // 1us

    *SPM_CONN_TOP_OFF_PWR_CON = 0x1D;  // [0]: rstb = 1
    hal_gpt_delay_us(1); // 1us

    *SPM_CONN_TOP_OFF_PWR_CON = 0xD;   // [4]: clk_dis = 0
    hal_gpt_delay_us(1); // 1us

    //turn CONN_TOP_OFF protect_en=0
    *CONNSYS_OFF_PROT_EN = 0x0;
    //wait CONN_TOP_OFF protect ready=0
    while (*CONNSYS_OFF_PROT_RDY != 0x0);
}

static void spm_mtcmos_conn_top_off_off(void)
{

    /* SPM Clock Force to 26M bar, *SPM_CLK_SW_CON &= ~(1 << 0) */
    //*SPM_CLK_SW_CON &= ~(1 << 0);

    if ((*SPM_PWR_STATUS & 0x8) == 0) {
        // log_hal_msgid_info("spm_mtcmos_conn_top_off is already off\r\n", 0);
        return;
    }

    //turn CONN_TOP_OFF protect_en=1
    *CONNSYS_OFF_PROT_EN = 0x1;
    //wait CONN_TOP_OFF protect ready=1
    while (*CONNSYS_OFF_PROT_RDY != 0x1);

    /*TINFO = " --- CONN_TOP_OFF power down by API "*/
    *SPM_CONN_TOP_OFF_PWR_CON = 0x1D; // [4]: clk_dis = 1
    hal_gpt_delay_us(1); // 1us

    *SPM_CONN_TOP_OFF_PWR_CON = 0x1F; // [1]: iso = 1
    hal_gpt_delay_us(1); // 1us

//// --- CONN_TOP_OFF SRAM Power Down begin ------

//// --- CONN_TOP_OFF SRAM end Power Down------

    *SPM_CONN_TOP_OFF_PWR_CON = 0x1E; // [0]: rstb = 0
    hal_gpt_delay_us(1); // 1us

    *SPM_CONN_TOP_OFF_PWR_CON = 0x1A; // [2]: pwr_on = 0
    hal_gpt_delay_us(1); // 1us

    *SPM_CONN_TOP_OFF_PWR_CON = 0x12; // [3]: pwr_on_2nd = 0
    hal_gpt_delay_us(1); // 1us

    //=======Workaroud start
    //turn CONN_TOP_OFF protect_en=0
    *CONNSYS_OFF_PROT_EN = 0x0;
    //wait CONN_TOP_OFF protect ready=0
    while (*CONNSYS_OFF_PROT_RDY != 0x0);
    //=======Workaroud end
}

static void spm_mtcmos_dsp_on(void)
{

    /* SPM Clock Force to 26M bar, *SPM_CLK_SW_CON &= ~(1 << 0) */
    //*SPM_CLK_SW_CON &= ~(1 << 0);

    if ((*SPM_PWR_STATUS & 0x80) != 0) {
        // log_hal_msgid_info("spm_mtcmos_dsp is already on\r\n", 0);
        return;
    }

    MCU_CFG_PRI->DSP0CFG_STALL = 1;

    *SPM_IGNORE_CPU_ACTIVE &= ~(1 << 2);   //IGNORE_DSP_ACTIVE
    MCU_CFG_PRI->DSP0_DEEP_SLEEP = 0;

    /*TINFO = " --- DSP power on by DSP API "*/
    //*DSP_PWR_CON = 0x12; sleep
    *SPM_DSP_PWR_CON = 0x16; // [2]: pwr_on = 1
    hal_gpt_delay_us(1); // 1us
    *SPM_DSP_PWR_CON = 0x1E; // [3]: pwr_on_2nd = 1
    hal_gpt_delay_us(1); // 1us


// --- DSP SRAM begin ------
    *SPM_DSP_DRAM0_CONTROL_1 = 0xFF0001FE; // sleepb=1, pd=0
    *SPM_DSP_DRAM0_CONTROL_1 = 0xFF0003FC;
    *SPM_DSP_DRAM0_CONTROL_1 = 0xFF0007F8;
    *SPM_DSP_DRAM0_CONTROL_1 = 0xFF000FF0;
    *SPM_DSP_DRAM0_CONTROL_1 = 0xFF001FE0;
    *SPM_DSP_DRAM0_CONTROL_1 = 0xFF003FC0;
    *SPM_DSP_DRAM0_CONTROL_1 = 0xFF007F80;
    *SPM_DSP_DRAM0_CONTROL_1 = 0xFF00FF00;

    *SPM_DSP_DRAM1_CONTROL_1 = 0xFF0001FE;
    *SPM_DSP_DRAM1_CONTROL_1 = 0xFF0003FC;
    *SPM_DSP_DRAM1_CONTROL_1 = 0xFF0007F8;
    *SPM_DSP_DRAM1_CONTROL_1 = 0xFF000FF0;
    *SPM_DSP_DRAM1_CONTROL_1 = 0xFF001FE0;
    *SPM_DSP_DRAM1_CONTROL_1 = 0xFF003FC0;
    *SPM_DSP_DRAM1_CONTROL_1 = 0xFF007F80;
    *SPM_DSP_DRAM1_CONTROL_1 = 0xFF00FF00;

    *SPM_DSP_DTAG_CONTROL_1 = 0x01000100;
    *SPM_DSP_ITAG_CONTROL_1 = 0x01000100;
    *SPM_DSP_IRAM0_CONTROL_1 = 0x01000100;
    *SPM_DSP_IRAM1_CONTROL_1 = 0x01000100;
    *SPM_DSP_DCACHE_CONTROL_1 = 0x01000100;
    *SPM_DSP_ICACHE_CONTROL_1 = 0x01000100;
    hal_gpt_delay_us(2); // 2us

    *SPM_DSP_DRAM0_CONTROL_1 = 0xFFFFFF00;   //isointb=1
    *SPM_DSP_DRAM1_CONTROL_1 = 0xFFFFFF00;
    *SPM_DSP_DTAG_CONTROL_1 = 0x01010100;
    *SPM_DSP_ITAG_CONTROL_1 = 0x01010100;
    *SPM_DSP_IRAM0_CONTROL_1 = 0x01010100;
    *SPM_DSP_IRAM1_CONTROL_1 = 0x01010100;
    *SPM_DSP_DCACHE_CONTROL_1 = 0x01010100;
    *SPM_DSP_ICACHE_CONTROL_1 = 0x01010100;

    // --- DSP SRAM end ------
    *SPM_DSP_PWR_CON = 0xE;   // [4]: clk_dis = 0
    hal_gpt_delay_us(1); // 1us
    *SPM_DSP_PWR_CON = 0x1E;  // [4]: clk_dis = 1
    hal_gpt_delay_us(1); // 1us
    *SPM_DSP_PWR_CON = 0x1C;  // [4]: clk_dis = 1, iso = 0
    hal_gpt_delay_us(1); // 1us
    *SPM_DSP_PWR_CON = 0x1D;  // [0]: rstb = 1
    hal_gpt_delay_us(1); // 1us

// --- DSP SRAM begin ------
    *SPM_DSP_DRAM0_CONTROL_1 = 0x00FFFF00;   //mem_iso_en=0
    *SPM_DSP_DRAM1_CONTROL_1 = 0x00FFFF00;
    *SPM_DSP_DTAG_CONTROL_1 = 0x00010100;
    *SPM_DSP_ITAG_CONTROL_1 = 0x00010100;
    *SPM_DSP_IRAM0_CONTROL_1 = 0x00010100;
    *SPM_DSP_IRAM1_CONTROL_1 = 0x00010100;
    *SPM_DSP_DCACHE_CONTROL_1 = 0x00010100;
    *SPM_DSP_ICACHE_CONTROL_1 = 0x00010100;

// --- DSP SRAM end ------
    *SPM_DSP_PWR_CON = 0xD;   // [4]: clk_dis = 0
    hal_gpt_delay_us(1); // 1us

    //turn DSP protect_en=0
    *DSP_PROT_EN = 0x0;
    //wait DSP protect ready=0
    while (*DSP_PROT_RDY != 0x0);

    if (dsp_pwr_off_flag == 1) {
        *SPM_DSP_WAKEUP_SOURCE_MASK = dsp_wakeup_source_mask;
        dsp_pwr_off_flag = 0;
    }
}

static void spm_mtcmos_dsp_off(void)
{

    /* SPM Clock Force to 26M bar, *SPM_CLK_SW_CON &= ~(1 << 0) */
    //*SPM_CLK_SW_CON &= ~(1 << 0);

    if ((*SPM_PWR_STATUS & 0x80) == 0) {
        // log_hal_msgid_info("spm_mtcmos_dsp is already off\r\n", 0);
        return;
    }

    MCU_CFG_PRI->DSP0CFG_STALL = 1;

    *SPM_IGNORE_CPU_ACTIVE |= 0x00100;   //IGNORE_DSP_ACTIVE
    if (dsp_pwr_off_flag == 0) {
        dsp_wakeup_source_mask = *SPM_DSP_WAKEUP_SOURCE_MASK;
        *SPM_DSP_WAKEUP_SOURCE_MASK = 0xFFFFFFFF;
        dsp_pwr_off_flag = 1;
    }

    //turn DSP protect_en=1
    *DSP_PROT_EN = 0x1;
    //wait DSP protect ready=1
    while (*DSP_PROT_RDY != 0x1);

    /*TINFO = " --- DSP power down by DSP API "*/
    *SPM_DSP_PWR_CON = 0x1D; // [4]: clk_dis = 1
    hal_gpt_delay_us(1); // 1us
    *SPM_DSP_PWR_CON = 0x1F; // [1]: iso = 1
    hal_gpt_delay_us(1); // 1us

//// --- DSP SRAM Power Down begin ------

    *SPM_DSP_DRAM0_CONTROL_1 = 0xFFFFFF00;   //mem_iso_en=1
    *SPM_DSP_DRAM1_CONTROL_1 = 0xFFFFFF00;
    *SPM_DSP_DTAG_CONTROL_1 = 0x01010100;
    *SPM_DSP_ITAG_CONTROL_1 = 0x01010100;
    *SPM_DSP_IRAM0_CONTROL_1 = 0x01010100;
    *SPM_DSP_IRAM1_CONTROL_1 = 0x01010100;
    *SPM_DSP_DCACHE_CONTROL_1 = 0x01010100;
    *SPM_DSP_ICACHE_CONTROL_1 = 0x01010100;

    *SPM_DSP_DRAM0_CONTROL_1 = 0xFF00FF00;   //isointb=0
    *SPM_DSP_DRAM1_CONTROL_1 = 0xFF00FF00;
    *SPM_DSP_DTAG_CONTROL_1 = 0x01000100;
    *SPM_DSP_ITAG_CONTROL_1 = 0x01000100;
    *SPM_DSP_IRAM0_CONTROL_1 = 0x01000100;
    *SPM_DSP_IRAM1_CONTROL_1 = 0x01000100;
    *SPM_DSP_DCACHE_CONTROL_1 = 0x01000100;
    *SPM_DSP_ICACHE_CONTROL_1 = 0x01000100;

    hal_gpt_delay_us(1); // 1us

    *SPM_DSP_DRAM0_CONTROL_1 = 0xFF00FE01;   //sleepb=0, pd=1
    *SPM_DSP_DRAM0_CONTROL_1 = 0xFF00FC03;
    *SPM_DSP_DRAM0_CONTROL_1 = 0xFF00F807;
    *SPM_DSP_DRAM0_CONTROL_1 = 0xFF00F00F;
    *SPM_DSP_DRAM0_CONTROL_1 = 0xFF00E01F;
    *SPM_DSP_DRAM0_CONTROL_1 = 0xFF00C03F;
    *SPM_DSP_DRAM0_CONTROL_1 = 0xFF00807F;
    *SPM_DSP_DRAM0_CONTROL_1 = 0xFF0000FF;

    *SPM_DSP_DRAM1_CONTROL_1 = 0xFF00FE01;   //sleepb=0, pd=1
    *SPM_DSP_DRAM1_CONTROL_1 = 0xFF00FC03;
    *SPM_DSP_DRAM1_CONTROL_1 = 0xFF00F807;
    *SPM_DSP_DRAM1_CONTROL_1 = 0xFF00F00F;
    *SPM_DSP_DRAM1_CONTROL_1 = 0xFF00E01F;
    *SPM_DSP_DRAM1_CONTROL_1 = 0xFF00C03F;
    *SPM_DSP_DRAM1_CONTROL_1 = 0xFF00807F;
    *SPM_DSP_DRAM1_CONTROL_1 = 0xFF0000FF;

    *SPM_DSP_DTAG_CONTROL_1 = 0x01000001;
    *SPM_DSP_ITAG_CONTROL_1 = 0x01000001;
    *SPM_DSP_IRAM0_CONTROL_1 = 0x01000001;
    *SPM_DSP_IRAM1_CONTROL_1 = 0x01000001;
    *SPM_DSP_DCACHE_CONTROL_1 = 0x01000001;
    *SPM_DSP_ICACHE_CONTROL_1 = 0x01000001;
//// --- DSP SRAM end Power Down------

    *SPM_DSP_PWR_CON = 0x1E; // [0]: rstb = 0
    hal_gpt_delay_us(1); // 1us
    *SPM_DSP_PWR_CON = 0x1A; // [2]: pwr_on = 0
    hal_gpt_delay_us(1); // 1us
    *SPM_DSP_PWR_CON = 0x12; // [3]: pwr_on_2nd = 0
    hal_gpt_delay_us(1); // 1us

}

static void spm_mtcmos_perisys_on(void)
{

    /* SPM Clock Force to 26M bar, *SPM_CLK_SW_CON &= ~(1 << 0) */
    //*SPM_CLK_SW_CON &= ~(1 << 0);

    if ((*SPM_PWR_STATUS & 0x100) != 0) {
        // log_hal_msgid_info("spm_mtcmos_perisys is already on\r\n", 0);
        return;
    }

    /*TINFO = " --- PERISYS power on by PERISYS API "*/
    //*SPM_PERISYS_PWR_CON = 0x12; sleep
    *SPM_PERISYS_PWR_CON = 0x16; // [2]: pwr_on = 1
    hal_gpt_delay_us(1); // 1us
    *SPM_PERISYS_PWR_CON = 0x1E; // [3]: pwr_on_2nd = 1
    hal_gpt_delay_us(1); // 1us

// --- PERISYS SRAM begin ------
    *SPM_USB_SRAM_CONTROL_1 = 0x01000100;//[24]:MEM_ISO_EN [16]:ISOINTB [8]:SLEEPB [0]:PD
    hal_gpt_delay_us(2); // wait sleepb to isointb  > 2us
    *SPM_USB_SRAM_CONTROL_1 = 0x01010100;//[24]:MEM_ISO_EN [16]:ISOINTB [8]:SLEEPB [0]:PD
// --- PERISYS SRAM end ------

    *SPM_PERISYS_PWR_CON = 0xE;   // [4]: clk_dis = 0
    hal_gpt_delay_us(1); // 1us
    *SPM_PERISYS_PWR_CON = 0x1E;  // [4]: clk_dis = 1
    hal_gpt_delay_us(1); // 1us
    *SPM_PERISYS_PWR_CON = 0x1C;  // [4]: clk_dis = 1, iso = 0
    hal_gpt_delay_us(1); // 1us
    *SPM_PERISYS_PWR_CON = 0x1D;  // [0]: rstb = 1
    hal_gpt_delay_us(1); // 1us

// --- PERISYS SRAM MEM_ISO_EN begin ------
    *SPM_USB_SRAM_CONTROL_1 = 0x00010100;//[24]:MEM_ISO_EN [16]:ISOINTB [8]:SLEEPB [0]:PD

// --- PERISYS SRAM end ------
// disable i3c_cg, workaround for posim timing violation
    /*TINFO = " --- I3C CG power off "*/
    *XO_PDN_TOP_SETD0 = *XO_PDN_TOP_SETD0 | 0x10; //[4]i3c_cg

    *SPM_PERISYS_PWR_CON = 0xD;   // [4]: clk_dis = 0
    hal_gpt_delay_us(1); // 1us

    /*TINFO = " --- I3C CG power on "*/
    *XO_PDN_TOP_CLRD0 = *XO_PDN_TOP_CLRD0 | 0x10; //[4]i3c_cg

    //turn PERISYS protect_en=0
    *PERISYS_PROT_EN = 0x0;
    //wait PERISYS protect ready=0
    while (*PERISYS_PROT_RDY != 0x0);

    /*TINFO = " --- USB, SPISLV, I3C CG power on "*/
    *XO_PDN_TOP_CLRD0 = *XO_PDN_TOP_CLRD0 | 0x180000; //[20]usb_cg, [19]spislv_cg [4]i3c_cg

    // disable i3c_cg, workaround for posim timing violation
    /*TINFO = " --- I3C CG power off "*/
    *XO_PDN_TOP_SETD0 = *XO_PDN_TOP_SETD0 | 0x10; //[4]i3c_cg
}

static void spm_mtcmos_perisys_off(void)
{

    /* SPM Clock Force to 26M bar, *SPM_CLK_SW_CON &= ~(1 << 0) */
    //*SPM_CLK_SW_CON &= ~(1 << 0);

    if ((*SPM_PWR_STATUS & 0x100) == 0) {
        // log_hal_msgid_info("spm_mtcmos_perisys is already off\r\n", 0);
        return;
    }

    /*TINFO = " --- USB, SPISLV, I3C CG power off "*/
    *XO_PDN_TOP_SETD0 = *XO_PDN_TOP_SETD0 | 0x180000; //[20]usb_cg, [19]spislv_cg [4]i3c_cg

    /*TINFO = " --- PERISYS power down by PERISYS API "*/
    *SPM_PERISYS_PWR_CON = 0x1D; // [4]: clk_dis = 1
    hal_gpt_delay_us(1); // 1us
    *SPM_PERISYS_PWR_CON = 0x1F; // [1]: iso = 1
    hal_gpt_delay_us(1); // 1us

//// --- PERISYS SRAM Power Down begin ------

    *SPM_USB_SRAM_CONTROL_1 = 0x01010100;//[24]:MEM_ISO_EN=1
    *SPM_USB_SRAM_CONTROL_1 = 0x01000100;//[16]:ISOINTB=0
    hal_gpt_delay_us(1); // wait isointb to sleepb  > 1us
    *SPM_USB_SRAM_CONTROL_1 = 0x01000001;//[8]:SLEEPB=0 [0]:PD=1

//// --- PERISYS SRAM end Power Down------

    *SPM_PERISYS_PWR_CON = 0x1E; // [0]: rstb = 0
    hal_gpt_delay_us(1); // 1us
    *SPM_PERISYS_PWR_CON = 0x1A; // [2]: pwr_on = 0
    hal_gpt_delay_us(1); // 1us
    *SPM_PERISYS_PWR_CON = 0x12; // [3]: pwr_on_2nd = 0
    hal_gpt_delay_us(1); // 1us

    /*TINFO = " --- I3C CG power on "*/
    *XO_PDN_TOP_CLRD0 = *XO_PDN_TOP_CLRD0 | 0x10; //[4]i3c_cg

    //turn PERISYS protect_en=1
    *PERISYS_PROT_EN = 0x1;
    //wait PERISYS protect ready=1
    while (*PERISYS_PROT_RDY != 0x1);

// disable i3c_cg, workaround for posim timing violation
    /*TINFO = " --- I3C CG power off "*/
    *XO_PDN_TOP_SETD0 = *XO_PDN_TOP_SETD0 | 0x10; //[4]i3c_cg
}

static void spm_mtcmos_vow_on(void)
{

    /* SPM Clock Force to 26M bar, *SPM_CLK_SW_CON &= ~(1 << 0) */
    //*SPM_CLK_SW_CON &= ~(1 << 0);

    if ((*SPM_PWR_STATUS & 0x200) != 0) {
        // log_hal_msgid_info("spm_mtcmos_vow is already on\r\n", 0);
        return;
    }

    /*TINFO = " --- VOW power on by CMSYS API "*/
    //*VOW_PWR_CON = 0x12; sleep
    *SPM_VOW_PWR_CON = 0x16; // [2]: pwr_on = 1
    hal_gpt_delay_us(1); // 1us
    *SPM_VOW_PWR_CON = 0x1E; // [3]: pwr_on_2nd = 1
    hal_gpt_delay_us(1); // 1us

    // --- VOW SRAM begin ------
    //*VOW_SRAM_CONTROL_1 = 0x01010100;//[24]:MEM_ISO_EN [16]:ISOINTB [8]:SLEEPB [0]:PD

    // --- VOW SRAM end ------
    *SPM_VOW_PWR_CON = 0xE;   // [4]: clk_dis = 0
    hal_gpt_delay_us(1); // 1us
    *SPM_VOW_PWR_CON = 0x1E;  // [4]: clk_dis = 1
    hal_gpt_delay_us(1); // 1us
    *SPM_VOW_PWR_CON = 0x1C;  // [4]: clk_dis = 1, iso = 0
    hal_gpt_delay_us(1); // 1us
    *SPM_VOW_PWR_CON = 0x1D;  // [0]: rstb = 1
    hal_gpt_delay_us(1); // 1us

    // --- VOW SRAM MEM_ISO_EN begin ------
    //*VOW_SRAM_CONTROL_1 = 0x00010100;//[24]:MEM_ISO_EN [16]:ISOINTB [8]:SLEEPB [0]:PD

    // --- VOW SRAM end ------
    *SPM_VOW_PWR_CON = 0xD;   // [4]: clk_dis = 0
    hal_gpt_delay_us(1); // 1us

    //turn VOW protect_en=0
    *VOW_PROT_EN = 0x0;
    //wait VOW protect ready=0
    while (*VOW_PROT_RDY != 0x0);
}

static void spm_mtcmos_vow_off(void)
{

    /* SPM Clock Force to 26M bar, *SPM_CLK_SW_CON &= ~(1 << 0) */
    //*SPM_CLK_SW_CON &= ~(1 << 0);

    if ((*SPM_PWR_STATUS & 0x200) == 0) {
        // log_hal_msgid_info("spm_mtcmos_vow is already off\r\n", 0);
        return;
    }

    //turn VOW protect_en=1
    *VOW_PROT_EN = 0x1;
    //wait VOW protect ready=1
    while (*VOW_PROT_RDY != 0x1);

    /*TINFO = " --- VOW power down by CMSYS API "*/
    *SPM_VOW_PWR_CON = 0x1D; // [4]: clk_dis = 1
    hal_gpt_delay_us(1); // 1us
    *SPM_VOW_PWR_CON = 0x1F; // [1]: iso = 1
    hal_gpt_delay_us(1); // 1us

//// --- VOW SRAM Power Down begin ------

//*VOW_SRAM_CONTROL_1 = 0x01010100;//[24]:MEM_ISO_EN=1
//*VOW_SRAM_CONTROL_1 = 0x01000100;//[16]:ISOINTB=0
//  *MDM_TM_WAIT_US = 1; // wait isointb to sleepb  > 1us
//*VOW_SRAM_CONTROL_1 = 0x01000001;//[8]:SLEEPB=0 [0]:PD=1
//// --- VOW SRAM end Power Down------

    *SPM_VOW_PWR_CON = 0x1E; // [0]: rstb = 0
    hal_gpt_delay_us(1); // 1us
    *SPM_VOW_PWR_CON = 0x1A; // [2]: pwr_on = 0
    hal_gpt_delay_us(1); // 1us
    *SPM_VOW_PWR_CON = 0x12; // [3]: pwr_on_2nd = 0
    hal_gpt_delay_us(1); // 1us
}

static void spm_mtcmos_colias_top_on(void)
{

    /* SPM Clock Force to 26M bar, *SPM_CLK_SW_CON &= ~(1 << 0) */
    //*SPM_CLK_SW_CON &= ~(1 << 0);

    if ((*SPM_PWR_STATUS & 0x800) != 0) {
        // log_hal_msgid_info("spm_mtcmos_colias_top is already on\r\n", 0);
        return;
    }

    /*TINFO = " --- COLIAS_TOP power on by CM33 API "*/
    //*COLIAS_TOP_PWR_CON = 0x12; sleep
    *SPM_COLIAS_TOP_PWR_CON = 0x16; // [2]: pwr_on = 1
    hal_gpt_delay_us(1); // 1us
    *SPM_COLIAS_TOP_PWR_CON = 0x1E; // [3]: pwr_on_2nd = 1
    hal_gpt_delay_us(1); // 1us

// --- COLIAS_TOP SRAM begin ------
    *SPM_COLIASSYS_RAM_CONTROL_1  = 0x03000300; // [25:24]:MEM_ISO_EN [17:16]:ISOINTB [9:8]:SLEEPB [1:0]:PD
    hal_gpt_delay_us(2); // 2us
    *SPM_COLIASSYS_RAM_CONTROL_1  = 0x03030300; // [25:24]:MEM_ISO_EN [17:16]:ISOINTB [9:8]:SLEEPB [1:0]:PD
    hal_gpt_delay_us(1); // 1us

// --- COLIAS_TOP SRAM end ------

    *SPM_COLIAS_TOP_PWR_CON = 0xE;   // [4]: clk_dis = 0
    hal_gpt_delay_us(1); // 1us
    *SPM_COLIAS_TOP_PWR_CON = 0x1E;  // [4]: clk_dis = 1
    hal_gpt_delay_us(1); // 1us
    *SPM_COLIAS_TOP_PWR_CON = 0x1C;  // [4]: clk_dis = 1, iso = 0
    hal_gpt_delay_us(1); // 1us
    *SPM_COLIAS_TOP_PWR_CON = 0x1D;  // [0]: rstb = 1
    hal_gpt_delay_us(1); // 1us

// --- COLIAS_TOP SRAM MEM_ISO_EN begin ------
    *SPM_COLIASSYS_RAM_CONTROL_1  = 0x00030300; // [25:24]:MEM_ISO_EN [17:16]:ISOINTB [9:8]:SLEEPB [1:0]:PD
    hal_gpt_delay_us(1); // 1us

// --- COLIAS_TOP SRAM end ------

    *SPM_COLIAS_TOP_PWR_CON = 0xD;   // [4]: clk_dis = 0
    hal_gpt_delay_us(1); // 1us

    //turn COLIAS_TOP protect_en=0
    *COLIAS_PROT_EN = 0x0;
    //wait COLIAS_TOP protect ready=0
    while (*COLIAS_PROT_RDY != 0x0);
}

static void spm_mtcmos_colias_top_off(void)
{

    /* SPM Clock Force to 26M bar, *SPM_CLK_SW_CON &= ~(1 << 0) */
    //*SPM_CLK_SW_CON &= ~(1 << 0);

    if ((*SPM_PWR_STATUS & 0x800) == 0) {
        // log_hal_msgid_info("spm_mtcmos_colias_top is already off\r\n", 0);
        return;
    }

#ifdef COLIAS_SRAM_SLEEP
    *COLIASSYS_RAM_CONTROL_0     = 0x0;
#else
#endif
    //turn COLIAS_TOP protect_en=1
    *COLIAS_PROT_EN = 0x1;
    //wait COLIAS_TOP protect ready=1
    while (*COLIAS_PROT_RDY != 0x1);

    /*TINFO = " --- COLIAS_TOP power down by CM33 API "*/
    *SPM_COLIAS_TOP_PWR_CON = 0x1D; // [4]: clk_dis = 1
    hal_gpt_delay_us(1); // 1us
    *SPM_COLIAS_TOP_PWR_CON = 0x1F; // [1]: iso = 1
    hal_gpt_delay_us(1); // 1us

//// --- COLIAS_TOP SRAM Power Down begin ------
    *SPM_COLIASSYS_RAM_CONTROL_1  = 0x03030300; // [25:24]:MEM_ISO_EN [17:16]:ISOINTB [9:8]:SLEEPB [1:0]:PD
    hal_gpt_delay_us(1); // 1us
    *SPM_COLIASSYS_RAM_CONTROL_1  = 0x03000300; // [25:24]:MEM_ISO_EN [17:16]:ISOINTB [9:8]:SLEEPB [1:0]:PD
    hal_gpt_delay_us(1); // wait isointb to sleepb  > 1us
    *SPM_COLIASSYS_RAM_CONTROL_1  = 0x03000003; // [25:24]:MEM_ISO_EN [17:16]:ISOINTB [9:8]:SLEEPB [1:0]:PD
    hal_gpt_delay_us(1); // 1us

//// --- COLIAS_TOP SRAM end Power Down------

    *SPM_COLIAS_TOP_PWR_CON = 0x1E; // [0]: rstb = 0
    hal_gpt_delay_us(1); // 1us
    *SPM_COLIAS_TOP_PWR_CON = 0x1A; // [2]: pwr_on = 0
    hal_gpt_delay_us(1); // 1us
    *SPM_COLIAS_TOP_PWR_CON = 0x12; // [3]: pwr_on_2nd = 0
    hal_gpt_delay_us(1); // 1us

}

#endif
